/dts-v1/;

/ {
	compatible = "sprd,LE6h";
	model = "Spreadtrum UMS9230 4H10 Board";
	sprd,sc-id = "ums9230 LE6h 1000";

	__fixups__ {
		adi_bus = "/fragment@30:target:0";
		aon_clk = "/fragment/__overlay__/sprd-marlin3:clocks:0";
		aonapb_gate = "/fragment/__overlay__/sprd-marlin3:clocks:12";
		ap_gpio = "/fragment/__overlay__/fingerprint@0:fpreset-gpios:0", "/fragment/__overlay__/gpio-keys/key-volumedown:gpios:0", "/fragment/__overlay__/sprd_front_flash:flash-strobe-gpios:0", "/fragment/__overlay__/audio-voice-trig:irq_gpio:0", "/fragment/__overlay__/sprd-marlin3:m2-wakeup-ap-gpios:0", "/fragment/__overlay__/sprd-marlin3:reset-gpios:0", "/fragment/__overlay__/sprd-marlin3:enable-gpios:0", "/fragment/__overlay__/sprd-marlin3:m2-to-ap-irq-gpios:0", "/fragment/__overlay__/sprd-fm:sprd,hp_lna_gpio:0", "/fragment@4/__overlay__/sensor-main@20:reset-gpios:0", "/fragment@4/__overlay__/sensor-main@20:power-down-gpios:0", "/fragment@5/__overlay__/sensor-sub@5a:reset-gpios:0", "/fragment@5/__overlay__/sensor-sub@5a:power-down-gpios:0", "/fragment@5/__overlay__/sensor-main2@20:avdd-gpios:0", "/fragment@5/__overlay__/sensor-main2@20:power-down-gpios:0", "/fragment@7/__overlay__/sensor-sub2@6e:avdd-gpios:0", "/fragment@7/__overlay__/sensor-sub2@6e:reset-gpios:0", "/fragment@7/__overlay__/sgm41516@6B:chg-dpdm-sel:0", "/fragment@7/__overlay__/sgm41516@6B:chg-dpdm-en:0", "/fragment@7/__overlay__/sgm41516@6B:chg-usb-dm:0", "/fragment@20/__overlay__:sprd,spk-ext-pa-gpio:0", "/fragment@23/__overlay__:reset-gpio:0";
		cam_backlight = "/fragment/__overlay__/sprd_front_flash:sprd,backlight-oled:0";
		chosen = "/fragment@1:target:0";
		csi0 = "/fragment@5/__overlay__/sensor-sub@5a:csi:0";
		csi1 = "/fragment@4/__overlay__/sensor-main@20:csi:0";
		csi2 = "/fragment@5/__overlay__/sensor-main2@20:csi:0", "/fragment@7/__overlay__/sensor-sub2@6e:csi:0";
		ddr_dfs = "/fragment@27:target:0";
		dpu = "/fragment@24:target:0";
		dvfs_dcdc_cpu0_supply = "/fragment@11:target:0";
		dvfs_dcdc_cpu1_supply = "/fragment@12:target:0";
		eic_async = "/fragment/__overlay__/fingerprint@0:fpint-gpios:0";
		eic_debounce = "/fragment@8/__overlay__:id-gpio:0";
		eic_sync = "/fragment@14/__overlay__:cd-gpios:0";
		ext_26m = "/fragment@4/__overlay__/sensor-main@20:clocks:40", "/fragment@5/__overlay__/sensor-sub@5a:clocks:40", "/fragment@5/__overlay__/sensor-main2@20:clocks:40", "/fragment@7/__overlay__/sensor-sub2@6e:clocks:40";
		ext_32k = "/fragment/__overlay__/sprd-marlin3:clocks:8";
		extcon_gpio = "/fragment/__overlay__/charger-manager/regulator@0/cable@0:extcon:0", "/fragment@7/__overlay__/sgm41516@6B:extcon:0", "/fragment@8:target:0", "/fragment@10/__overlay__:extcon:0", "/fragment@13/__overlay__:extcon:0";
		hsphy = "/fragment/__overlay__/chg_ufc20:phys:0", "/fragment@7/__overlay__/sgm41516@6B:phys:0", "/fragment@10:target:0", "/fragment@25/__overlay__:phys:0";
		i2c0 = "/fragment@4:target:0";
		i2c1 = "/fragment@5:target:0";
		i2c3 = "/fragment@16:target:0";
		i2c4 = "/fragment@17:target:0";
		i2c5 = "/fragment@6:target:0";
		i2c6 = "/fragment@7:target:0";
		ion = "/fragment@15:target:0", "/fragment@29:target:0";
		mm_clk = "/fragment@4/__overlay__/sensor-main@20:clocks:0", "/fragment@5/__overlay__/sensor-sub@5a:clocks:0", "/fragment@5/__overlay__/sensor-main2@20:clocks:0", "/fragment@7/__overlay__/sensor-sub2@6e:clocks:0";
		mm_gate = "/fragment@4/__overlay__/sensor-main@20:clocks:8", "/fragment@5/__overlay__/sensor-sub@5a:clocks:8", "/fragment@5/__overlay__/sensor-main2@20:clocks:8", "/fragment@7/__overlay__/sensor-sub2@6e:clocks:8";
		panel = "/fragment@23:target:0";
		pdm_dmic = "/fragment@19:target:0";
		pin_controller = "/fragment@9:target:0", "/fragment@28:target:0";
		pll1 = "/fragment@4/__overlay__/sensor-main@20:clocks:16", "/fragment@4/__overlay__/sensor-main@20:clocks:24", "/fragment@4/__overlay__/sensor-main@20:clocks:32", "/fragment@5/__overlay__/sensor-sub@5a:clocks:16", "/fragment@5/__overlay__/sensor-sub@5a:clocks:24", "/fragment@5/__overlay__/sensor-sub@5a:clocks:32", "/fragment@5/__overlay__/sensor-main2@20:clocks:16", "/fragment@5/__overlay__/sensor-main2@20:clocks:24", "/fragment@5/__overlay__/sensor-main2@20:clocks:32", "/fragment@7/__overlay__/sensor-sub2@6e:clocks:16", "/fragment@7/__overlay__/sensor-sub2@6e:clocks:24", "/fragment@7/__overlay__/sensor-sub2@6e:clocks:32";
		pmic_adc = "/fragment/__overlay__/thermal-sensor:io-channels:0", "/fragment/__overlay__/pa-sensor:io-channels:0", "/fragment/__overlay__/chg-sensor:io-channels:0", "/fragment@22/__overlay__:io-channels:0", "/fragment@22/__overlay__:io-channels:8", "/fragment@22/__overlay__:io-channels:16";
		pmic_eic = "/fragment/__overlay__/gpio-keys/key-volumeup:gpios:0", "/fragment/__overlay__/gpio-keys/key-power:gpios:0";
		pmic_fchg = "/fragment@25:target:0";
		pmic_fgu = "/fragment@22:target:0";
		pmic_pd = "/fragment@26:target:0";
		reserved_memory = "/fragment@2:target:0";
		sdio0 = "/fragment@14:target:0";
		sdio1 = "/fragment/__overlay__/sprd-marlin3:sdhci-name:0", "/fragment@0:target:0";
		sound_vbc_v4_sprd_codec = "/fragment@20:target:0";
		sprd_headset = "/fragment@18:target:0";
		thm_zone = "/fragment@3:target:0";
		usb = "/fragment@13:target:0";
		vddcama0 = "/fragment@4/__overlay__/sensor-main@20:vddcama-supply:0";
		vddcama1 = "/fragment@5/__overlay__/sensor-sub@5a:vddcama-supply:0", "/fragment@5/__overlay__/sensor-main2@20:vddcama-supply:0";
		vddcamd0 = "/fragment@4/__overlay__/sensor-main@20:vddcamd-supply:0";
		vddcamd1 = "/fragment@5/__overlay__/sensor-sub@5a:vddcamd-supply:0", "/fragment@7/__overlay__/sensor-sub2@6e:vddcamd-supply:0";
		vddcamio = "/fragment@4/__overlay__/sensor-main@20:vddio-supply:0", "/fragment@5/__overlay__/sensor-sub@5a:vddio-supply:0", "/fragment@7/__overlay__/sensor-sub2@6e:vddio-supply:0";
		vddcammot = "/fragment@4/__overlay__/sensor-main@20:vddcammot-supply:0", "/fragment@5/__overlay__/sensor-sub@5a:vddcammot-supply:0", "/fragment@7/__overlay__/sensor-sub2@6e:vddcammot-supply:0";
		vddldo0 = "/fragment@21:target:0";
		vddsim2 = "/fragment/__overlay__/sprd-marlin3:dcxo18-supply:0";
		vddusb33 = "/fragment@10/__overlay__:vdd-supply:0";
		vddwcn = "/fragment/__overlay__/sprd-marlin3:avdd12-supply:0";
		vddwifipa = "/fragment/__overlay__/sprd-marlin3:avdd33-supply:0";
	};

	__local_fixups__ {

		fragment {

			__overlay__ {

				charger-manager {
					monitored-battery = <0x0>;
				};

				chg_ufc20 {
					monitored-battery = <0x0>;
				};
			};
		};

		fragment@13 {

			__overlay__ {
				vbus-supply = <0x0>;
			};
		};

		fragment@15 {

			__overlay__ {

				heap@3 {
					memory-region = <0x0>;
				};
			};
		};

		fragment@22 {

			__overlay__ {
				monitored-battery = <0x0>;
			};
		};

		fragment@24 {

			__overlay__ {
				sprd,logo-memory = <0x0>;
				sprd,wb-memory = <0x0>;
			};
		};

		fragment@28 {

			__overlay__ {
				pinctrl-0 = <0x0>;
				pinctrl-1 = <0x0>;
				pinctrl-2 = <0x0>;
				pinctrl-3 = <0x0>;
				pinctrl-4 = <0x0>;
				pinctrl-5 = <0x0>;
				pinctrl-6 = <0x0>;
			};
		};

		fragment@29 {

			__overlay__ {

				heap@4 {
					memory-region = <0x0>;
				};
			};
		};

		fragment@3 {

			__overlay__ {

				board-thmzone {
					thermal-sensors = <0x0>;
				};

				chg-thmzone {
					thermal-sensors = <0x0>;
				};

				pa-thmzone {
					thermal-sensors = <0x0>;
				};
			};
		};

		fragment@7 {

			__overlay__ {

				sgm41516@6B {
					monitored-battery = <0x0>;
				};
			};
		};

		fragment@8 {

			__overlay__ {
				pinctrl-0 = <0x0>;
				pinctrl-1 = <0x0>;
			};
		};
	};

	__symbols__ {
		bat = "/fragment/__overlay__/battery";
		bd_thmzone = "/fragment@3/__overlay__/board-thmzone";
		chg_thermistor = "/fragment/__overlay__/chg-sensor";
		chg_thmzone = "/fragment@3/__overlay__/chg-thmzone";
		cover_reserved = "/fragment@2/__overlay__/transsion-cover-reserved-memory@8df00000";
		fb_reserved = "/fragment@2/__overlay__/framebuffer-mem@fed70000";
		fd_reserved = "/fragment@2/__overlay__/faceid-mem@fe3ed000";
		flash_ic = "/fragment@6/__overlay__/flash-ic@63";
		gpio_124 = "/fragment@28/__overlay__/keyin0";
		gpio_175 = "/fragment@28/__overlay__/bt_rfctl2";
		gpio_22 = "/fragment@28/__overlay__/rfctl3";
		gpio_24 = "/fragment@28/__overlay__/rfctl5";
		gpio_25 = "/fragment@28/__overlay__/rfctl6";
		gpio_26 = "/fragment@28/__overlay__/rfctl7";
		gpio_8 = "/fragment@28/__overlay__/rfctl16";
		logo_reserved = "/fragment@2/__overlay__/logobuffer@9e000000";
		otgpin_pull_down = "/fragment@9/__overlay__/otgpin_pull_down";
		otgpin_pull_up = "/fragment@9/__overlay__/otgpin_pull_up";
		pa_thermistor = "/fragment/__overlay__/pa-sensor";
		pa_thmzone = "/fragment@3/__overlay__/pa-thmzone";
		sensor_main = "/fragment@4/__overlay__/sensor-main@20";
		sensor_main2 = "/fragment@5/__overlay__/sensor-main2@20";
		sensor_sub = "/fragment@5/__overlay__/sensor-sub@5a";
		sensor_sub2 = "/fragment@7/__overlay__/sensor-sub2@6e";
		sgm41516 = "/fragment@7/__overlay__/sgm41516@6B";
		sprd_marlin3 = "/fragment/__overlay__/sprd-marlin3";
		tboard_thermistor = "/fragment/__overlay__/thermal-sensor";
		usb_con = "/fragment@26/__overlay__/connector";
		vddvbus = "/fragment@7/__overlay__/sgm41516@6B/otg-vbus";
		wb_reserved = "/fragment@2/__overlay__/writeback-mem@fe8ed000";
	};

	fragment {
		target-path = [2f 00];

		__overlay__ {

			audio-voice-trig {
				compatible = "sprd,voice_trig";
				irq_gpio = <0xffffffff 0xa9 0x0>;
				status = "disable";
			};

			battery {
				capacity-temp-table = <0x32 0x64 0x19 0x64 0xa 0x60 0x0 0x51 0xfffffff6 0x38>;
				charge-cdp-current-microamp = <0x16e360 0x16e360>;
				charge-dcp-current-microamp = <0x1e8480 0x1e8480>;
				charge-full-design-microamp-hours = <0x4bf938>;
				charge-sdp-current-microamp = <0x7a120 0x7a120>;
				charge-term-current-microamp = <0x30d40>;
				charge-unknown-current-microamp = <0x7a120 0x7a120>;
				compatible = "simple-battery";
				constant_charge_voltage_max_microvolt = <0x432380>;
				factory-internal-resistance-micro-ohms = <0x2f1e8>;
				ic-voltage-temp-table = <0x1141f8 0xffff64c2 0x10eff0 0xffff8baf 0x106350 0xffffb3e8 0xeffd8 0xffffedb9 0xcc970 0x277e 0x9fab0 0x60e5 0x64d48 0xaf7a 0x4d260 0xd677 0x3a1b0 0xfd7f 0x2b750 0x12484 0x20788 0x14b93 0x186a0 0x172a3 0x124f8 0x199b0 0xdea8 0x1c0c9 0xa7f8 0x1e7c8>;
				ocv-capacity-celsius = <0x14>;
				ocv-capacity-table-0 = <0x42b620 0x64 0x41cfa8 0x5f 0x40f100 0x5a 0x401258 0x55 0x3f3b80 0x50 0x3e6c78 0x4b 0x3dad10 0x46 0x3cf578 0x41 0x3c3de0 0x3c 0x3b6ed8 0x37 0x3ae238 0x32 0x3a7ca8 0x2d 0x3a2aa0 0x28 0x39e838 0x23 0x39ada0 0x1e 0x396b38 0x19 0x391d18 0x14 0x38bf58 0xf 0x384a28 0xa 0x382318 0x5 0x33e140 0x0>;
				phandle = <0x1>;
				resistance-temp-table = <0x32 0x3b 0x19 0x64 0xa 0xcb 0x0 0x185 0xfffffff6 0x27c>;
				voltage-min-design-microvolt = <0x34a490>;
				voltage-temp-table = <0x23df98 0x320 0x2260c8 0x352 0x20b318 0x384 0x1eda70 0x3b6 0x1ce670 0x3e8 0x1adb00 0x41a 0x18bff0 0x44c 0x16a0f8 0x47e 0x148db8 0x4b0 0x128e00 0x4e2 0x10a5b8 0x514 0xee098 0x546 0xd32e8 0x578 0xbb800 0x5aa 0xa50a0 0x5dc 0x91ff0 0x60e 0x802c8 0x640 0x71480 0x672>;
			};

			charger-manager {
				cm-battery-cold = <0xc8>;
				cm-battery-cold-in-minus;
				cm-battery-hot = <0x258>;
				cm-battery-stat = <0x2>;
				cm-battery-temp-diff = <0x32>;
				cm-cap-remap-table = <0x1 0x2 0x3 0x2 0x3 0x2 0x62 0x63 0x2 0x63 0x64 0x3>;
				cm-capacity-track;
				cm-cdp-jeita-temp-table = <0x3e8 0x3fc 0x0 0x432380 0x47e 0x49c 0xaae60 0x432380 0x5b4 0x5a0 0x16e360 0x432380 0x60e 0x5dc 0x16e360 0x3e8fa0>;
				cm-charge-voltage-drop = <0xaae60>;
				cm-charge-voltage-max = <0xa037a0>;
				cm-chargers = "sgm41516_charger";
				cm-charging-max = <0x1499700>;
				cm-dcp-jeita-temp-table = <0x3e8 0x3fc 0x0 0x432380 0x47e 0x49c 0xaae60 0x432380 0x5b4 0x5a0 0x1e8480 0x432380 0x60e 0x5dc 0x1e8480 0x3e8fa0>;
				cm-discharging-max = <0x2932e0>;
				cm-fast-charge-voltage-drop = <0x7a120>;
				cm-fast-charge-voltage-max = <0xa037a0>;
				cm-fast-chargers = "ufc20_fast_charger";
				cm-fchg-jeita-temp-table = <0x3e8 0x3fc 0x0 0x432380 0x47e 0x49c 0x2dc6c0 0x432380 0x5b4 0x5a0 0x2dc6c0 0x432380 0x60e 0x5dc 0x16e360 0x3e8fa0>;
				cm-fuel-gauge = "sc27xx-fgu";
				cm-fullbatt-capacity = <0x64>;
				cm-fullbatt-current = <0x30d40>;
				cm-fullbatt-vchkdrop-ms = <0x7530>;
				cm-fullbatt-vchkdrop-volt = <0xea60>;
				cm-fullbatt-voltage = <0x42d560>;
				cm-name = "battery";
				cm-num-chargers = <0x1>;
				cm-num-fast-chargers = <0x1>;
				cm-one-cap-time = <0x1e>;
				cm-poll-interval = <0x3a98>;
				cm-poll-mode = <0x2>;
				cm-sdp-jeita-temp-table = <0x3e8 0x3fc 0x0 0x432380 0x47e 0x49c 0x7a120 0x432380 0x5b4 0x5a0 0x7a120 0x432380 0x60e 0x5dc 0x7a120 0x3e8fa0>;
				cm-shutdown-voltage = <0x2f4d60>;
				cm-tickle-time-out = <0x5dc>;
				cm-unknown-jeita-temp-table = <0x3e8 0x3fc 0x0 0x432380 0x47e 0x49c 0x7a120 0x432380 0x5b4 0x5a0 0x7a120 0x432380 0x60e 0x5dc 0x7a120 0x3e8fa0>;
				cm-wdt-interval = <0x1>;
				compatible = "charger-manager";
				monitored-battery = <0x1>;

				regulator@0 {
					cm-regulator-name = "vddgen";

					cable@0 {
						cm-cable-name = "USB";
						extcon = <0xffffffff>;
					};
				};
			};

			chg-sensor {
				#thermal-sensor-cells = <0x0>;
				compatible = "generic-adc-thermal";
				io-channel-names = "sensor-channel";
				io-channels = <0xffffffff 0x4>;
				phandle = <0x4>;
				temperature-lookup-table = <0xffff64c2 0x46b 0xffff8baf 0x456 0xffffb3e8 0x432 0xffffedb9 0x3d7 0x277e 0x346 0x60e5 0x28e 0xaf7a 0x19d 0xd677 0x13c 0xfd7f 0xee 0x12484 0xb2 0x14b93 0x85 0x172a3 0x64 0x199b0 0x4b 0x1c0c9 0x39 0x1e7c8 0x2b>;
			};

			chg_ufc20 {
				cm-chargers = "sgm41516_charger";
				cm-fuel-gauge = "sc27xx-fgu";
				cm-num-chargers = <0x1>;
				cm_fast_charge_18w_ilim = <0x249f00>;
				cm_fast_charge_hvdcp_ilim = <0x1e8480>;
				cm_fast_charge_pe20_ilim = <0x1e8480>;
				code_temp = <0x96>;
				code_temp_recovery = <0xaa>;
				compatible = "ufc20-fast-charger";
				en_ufc20;
				heat_temp = <0x1c2>;
				heat_temp_recovery = <0x1ae>;
				ichg_leave_thd = <0xf4240>;
				input_vol = <0x895440>;
				monitored-battery = <0x1>;
				phys = <0xffffffff>;
				status = "okay";
				ta_stop_soc = <0x5a>;
				vdd-regulator-name = "vddusb33";
			};

			fingerprint@0 {
				compatible = "chipone,fingerprint";
				fpint-gpios = <0xffffffff 0x1d 0x0>;
				fpreset-gpios = <0xffffffff 0xa9 0x0>;
			};

			gnss_common_ctl {
				compatible = "sprd,gnss_common_ctl";
				sprd,name = "gnss_common_ctl";
			};

			gpio-keys {
				compatible = "gpio-keys";

				key-power {
					debounce-interval = <0x2>;
					gpios = <0xffffffff 0x1 0x1>;
					label = "Power Key";
					linux,code = <0x74>;
					wakeup-source;
				};

				key-volumedown {
					debounce-interval = <0x2>;
					gpios = <0xffffffff 0x7c 0x1>;
					label = "Volume Down Key";
					linux,code = <0x72>;
					wakeup-source;
				};

				key-volumeup {
					debounce-interval = <0x2>;
					gpios = <0xffffffff 0x4 0x0>;
					label = "Volume Up Key";
					linux,code = <0x73>;
					wakeup-source;
				};
			};

			pa-sensor {
				#thermal-sensor-cells = <0x0>;
				compatible = "generic-adc-thermal";
				io-channel-names = "sensor-channel";
				io-channels = <0xffffffff 0x2>;
				phandle = <0x3>;
				temperature-lookup-table = <0xffff64c2 0x46b 0xffff8baf 0x456 0xffffb3e8 0x432 0xffffedb9 0x3d7 0x277e 0x346 0x60e5 0x28e 0xaf7a 0x19d 0xd677 0x13c 0xfd7f 0xee 0x12484 0xb2 0x14b93 0x85 0x172a3 0x64 0x199b0 0x4b 0x1c0c9 0x39 0x1e7c8 0x2b>;
			};

			sprd-fm {
				compatible = "sprd,marlin3-fm";
				sprd,hp_lna_gpio = <0xffffffff 0x72 0x0>;
				sprd,name = "sprd-fm";
			};

			sprd-marlin3 {
				adma-rx;
				adma-tx;
				avdd12-bound-wbreq = <0x1ac8 0x1000 0x0 0x1000>;
				avdd12-parent-bound-chip = <0x1a4c 0x1 0x0 0x1>;
				avdd12-supply = <0xffffffff>;
				avdd33-bound-wbreq = <0x1acc 0x4 0x0 0x4>;
				avdd33-supply = <0xffffffff>;
				clock-names = "clk_32k", "source", "enable";
				clocks = <0xffffffff 0x4 0xffffffff 0xffffffff 0x6>;
				compatible = "sprd,marlin3";
				dcxo18-supply = <0xffffffff>;
				enable-gpios = <0xffffffff 0x74 0x1>;
				m2-to-ap-irq-gpios = <0xffffffff 0x34 0x1>;
				m2-wakeup-ap-gpios = <0xffffffff 0x35 0x1>;
				phandle = <0x13>;
				reset-gpios = <0xffffffff 0xb1 0x1>;
				sdhci-name = <0xffffffff>;
				sprd,btwf-file-name = "/dev/block/by-name/wcnmodem";
				sprd,gnss-file-name = "/dev/block/by-name/gnssmodem";
			};

			sprd-mtty {
				compatible = "sprd,mtty";
				sprd,name = "ttyBT";
			};

			sprd-wlan {
				compatible = "sprd,sc2355-wifi";
			};

			sprd_front_flash {
				compatible = "sprd,flash_aw9968";
				flash-ic = <0x26f0>;
				flash-idx = <0x1>;
				flash-strobe-gpios = <0xffffffff 0x70 0x0>;
				sprd,backlight-oled = <0xffffffff>;
				status = "okay";
			};

			thermal-sensor {
				#thermal-sensor-cells = <0x0>;
				compatible = "generic-adc-thermal";
				io-channel-names = "sensor-channel";
				io-channels = <0xffffffff 0x1>;
				phandle = <0x2>;
				temperature-lookup-table = <0xffff64c2 0x46b 0xffff8baf 0x456 0xffffb3e8 0x432 0xffffedb9 0x3d7 0x277e 0x346 0x60e5 0x28e 0xaf7a 0x19d 0xd677 0x13c 0xfd7f 0xee 0x12484 0xb2 0x14b93 0x85 0x172a3 0x64 0x199b0 0x4b 0x1c0c9 0x39 0x1e7c8 0x2b>;
			};
		};
	};

	fragment@0 {
		target = <0xffffffff>;

		__overlay__ {
			bus-width = <0x4>;
			no-mmc;
			no-sd;
			sd-uhs-sdr104;
			sd-uhs-sdr50;
			sprd,name = "sdio_wifi";
			sprd,sdio-adma;
			sprd,sdr104-dly = <0x7f 0x7f 0x7f 0x7f>;
			sprd,sdr50-dly = <0x7f 0x7f 0x8f 0x8f>;
			status = "okay";
		};
	};

	fragment@1 {
		target = <0xffffffff>;

		__overlay__ {
			bootargs_ext = "androidboot.hardware=LE6h androidboot.dtbo_idx=0";
			transsion,emi-support = "KMDP60018M_B425";
		};
	};

	fragment@10 {
		target = <0xffffffff>;

		__overlay__ {
			extcon = <0xffffffff>;
			vdd-supply = <0xffffffff>;
		};
	};

	fragment@11 {
		target = <0xffffffff>;

		__overlay__ {
			chnl-in-i2c = <0x0>;
			pmic-type-num = <0x0>;
			slew-rate = <0x249f>;
			top-dvfs-adi-state = <0x70 0x0 0xf>;
			tuning-latency-us = <0x0>;
			voltage-down-delay = <0x32 0x64 0x0 0xffff 0x600 0x64 0x64 0x10 0xffff 0xa00 0x96 0x60 0x0 0xffff 0xf00 0xc8 0x60 0x10 0xffff 0x1400 0xfa 0x5c 0x0 0xffff 0x1900 0x12c 0x5c 0x10 0xffff 0x1e00 0x15e 0x114 0x0 0xffff 0x2300>;
			voltage-grade = <0x0 0xf0 0xf4 0x0 0x1ff 0x1 0xf0 0xf4 0x9 0x1ff 0x2 0x100 0xf4 0x12 0x1ff 0x3 0x110 0xf8 0x0 0x1ff 0x4 0x120 0xf8 0x9 0x1ff 0x5 0x130 0xf8 0x12 0x1ff 0x6 0x140 0xfc 0x0 0x1ff 0x7 0x140 0xfc 0x9 0x1ff>;
			voltage-grade-num = <0x8>;
			voltage-up-delay = <0x32 0x58 0x0 0xffff 0x600 0x64 0x58 0x10 0xffff 0xa00 0x96 0x54 0x0 0xffff 0xf00 0xc8 0x54 0x10 0xffff 0x1400 0xfa 0x50 0x0 0xffff 0x1900 0x12c 0x50 0x10 0xffff 0x1e00 0x15e 0x110 0x0 0xffff 0x2300>;
		};
	};

	fragment@12 {
		target = <0xffffffff>;

		__overlay__ {
			chnl-i2c-used;
			chnl-in-i2c = <0x1>;
			pmic-type-num = <0x2>;
			slew-rate = <0xfa0>;
			supply-type-sel = <0x120 0x0 0x1>;
			third-pmic-used;
			top-dvfs-i2c-state = <0x9c 0x4 0x1f>;
			tuning-latency-us = <0x0>;
			voltage-down-delay = <0x32 0x90 0x0 0xffff 0x600 0x64 0x90 0x10 0xffff 0xa00 0x96 0x8c 0x0 0xffff 0xf00 0xc8 0x8c 0x10 0xffff 0x1400 0xfa 0x88 0x0 0xffff 0x1900 0x12c 0x88 0x10 0xffff 0x1e00 0x15e 0x11c 0x0 0xffff 0x2300>;
			voltage-grade = <0x0 0x8f 0x12c 0x0 0xff 0x1 0x94 0x12c 0x8 0xff 0x2 0x99 0x12c 0x10 0xff 0x3 0x9e 0x12c 0x18 0xff 0x4 0xa3 0x130 0x0 0xff 0x5 0xa8 0x130 0x8 0xff 0x6 0xa8 0x130 0x10 0xff 0x7 0xa8 0x130 0x18 0xff>;
			voltage-grade-num = <0x8>;
			voltage-up-delay = <0x32 0x84 0x0 0xffff 0x1600 0x64 0x84 0x10 0xffff 0x1a00 0x96 0x80 0x0 0xffff 0x1f00 0xc8 0x80 0x10 0xffff 0x2400 0xfa 0x7c 0x0 0xffff 0x2900 0x12c 0x7c 0x10 0xffff 0x2e00 0x15e 0x118 0x0 0xffff 0x3300>;
		};
	};

	fragment@13 {
		target = <0xffffffff>;

		__overlay__ {
			extcon = <0xffffffff>;
			vbus-supply = <0x7>;
		};
	};

	fragment@14 {
		target = <0xffffffff>;

		__overlay__ {
			cd-gpios = <0xffffffff 0x23 0x0>;
			three-in-one-slot;
		};
	};

	fragment@15 {
		target = <0xffffffff>;

		__overlay__ {

			heap@3 {
				label = "carveout_fb";
				memory-region = <0x8>;
				reg = <0x3>;
				type = <0x2>;
			};
		};
	};

	fragment@16 {
		target = <0xffffffff>;

		__overlay__ {
			status = "okay";
		};
	};

	fragment@17 {
		target = <0xffffffff>;

		__overlay__ {
			clock-frequency = <0x61a80>;
			status = "okay";
			tsetup = <0x1>;
		};
	};

	fragment@18 {
		target = <0xffffffff>;

		__overlay__ {
			status = "okay";
		};
	};

	fragment@19 {
		target = <0xffffffff>;

		__overlay__ {
			status = "okay";
		};
	};

	fragment@2 {
		target = <0xffffffff>;

		__overlay__ {

			faceid-mem@fe3ed000 {
				phandle = <0x12>;
				reg = <0x0 0xfe3ed000 0x0 0x500000>;
			};

			framebuffer-mem@fed70000 {
				phandle = <0x8>;
				reg = <0x0 0xfed70000 0x0 0x1210000>;
			};

			logobuffer@9e000000 {
				phandle = <0x9>;
				reg = <0x0 0x9e000000 0x0 0x483000>;
			};

			transsion-cover-reserved-memory@8df00000 {
				compatible = "transsion,cover_reserved";
				phandle = <0x14>;
				reg = <0x0 0x8df00000 0x0 0x1000>;
			};

			writeback-mem@fe8ed000 {
				phandle = <0xa>;
				reg = <0x0 0xfe8ed000 0x0 0x483000>;
			};
		};
	};

	fragment@20 {
		target = <0xffffffff>;

		__overlay__ {
			sprd,spk-ext-pa-gpio = <0xffffffff 0x8b 0x0>;
			sprd,spk-ext-pa-info = <0x0 0x0 0x2 0x0>;
			status = "okay";
		};
	};

	fragment@21 {
		target = <0xffffffff>;

		__overlay__ {
			regulator-always-on;
		};
	};

	fragment@22 {
		target = <0xffffffff>;

		__overlay__ {
			first-calib-capacity = <0x32>;
			first-calib-voltage = <0x36a060>;
			io-channel-names = "bat-temp", "charge-vol", "ic-temp";
			io-channels = <0xffffffff 0x4 0xffffffff 0xe 0xffffffff 0x0>;
			monitored-battery = <0x1>;
			sprd,calib-resistance-real = <0x2710>;
			sprd,calib-resistance-spec = <0x4e20>;
		};
	};

	fragment@23 {
		target = <0xffffffff>;

		__overlay__ {
			reset-gpio = <0xffffffff 0x32 0x0>;
		};
	};

	fragment@24 {
		target = <0xffffffff>;

		__overlay__ {
			sprd,logo-memory = <0x9>;
			sprd,wb-memory = <0xa>;
		};
	};

	fragment@25 {
		target = <0xffffffff>;

		__overlay__ {
			phys = <0xffffffff>;
			sprd,input-voltage-microvolt = <0x4c4b40>;
		};
	};

	fragment@26 {
		target = <0xffffffff>;

		__overlay__ {
			status = "okay";

			connector {
				compatible = "usb-c-connector";
				label = "USB-C";
				op-sink-microwatt = <0x989680>;
				phandle = <0x1e>;
				power-role = "dual";
				sink-pdos = <0x40190c8 0xc0dc213c>;
				source-pdos = <0x4019028>;
				try-power-role = "sink";
			};
		};
	};

	fragment@27 {
		target = <0xffffffff>;

		__overlay__ {
			sprd-freq = <0x535 0x300 0x100 0x535 0x535 0xbacd 0x535>;
			sprd-scene = "boost", "lcdon", "lcdoff", "camlow", "camhigh", "camveryhigh", "faceid";
		};
	};

	fragment@28 {
		target = <0xffffffff>;

		__overlay__ {
			pinctrl-0 = <0xb>;
			pinctrl-1 = <0xc>;
			pinctrl-2 = <0xd>;
			pinctrl-3 = <0xe>;
			pinctrl-4 = <0xf>;
			pinctrl-5 = <0x10>;
			pinctrl-6 = <0x11>;
			pinctrl-names = "gpio_8", "gpio_22", "gpio_24", "gpio_25", "gpio_26", "gpio_124", "gpio_175";

			bt_rfctl2 {
				function = "func4";
				phandle = <0x11>;
				pins = "QOGIRL6_BT_RFCTL2";
			};

			keyin0 {
				function = "func4";
				phandle = <0x10>;
				pins = "QOGIRL6_KEYIN0";
			};

			rfctl16 {
				function = "func4";
				phandle = <0xb>;
				pins = "QOGIRL6_RFCTL16";
			};

			rfctl3 {
				function = "func4";
				phandle = <0xc>;
				pins = "QOGIRL6_RFCTL3";
			};

			rfctl5 {
				function = "func4";
				phandle = <0xd>;
				pins = "QOGIRL6_RFCTL5";
			};

			rfctl6 {
				function = "func4";
				phandle = <0xe>;
				pins = "QOGIRL6_RFCTL6";
			};

			rfctl7 {
				function = "func4";
				phandle = <0xf>;
				pins = "QOGIRL6_RFCTL7";
			};
		};
	};

	fragment@29 {
		target = <0xffffffff>;

		__overlay__ {

			heap@4 {
				label = "carveout_fd";
				memory-region = <0x12>;
				reg = <0x4>;
				type = <0x2>;
			};
		};
	};

	fragment@3 {
		target = <0xffffffff>;

		__overlay__ {

			board-thmzone {
				phandle = <0x15>;
				polling-delay = <0x0>;
				polling-delay-passive = <0x0>;
				thermal-sensors = <0x2>;
			};

			chg-thmzone {
				phandle = <0x17>;
				polling-delay = <0x0>;
				polling-delay-passive = <0x0>;
				thermal-sensors = <0x4>;
			};

			pa-thmzone {
				phandle = <0x16>;
				polling-delay = <0x0>;
				polling-delay-passive = <0x0>;
				thermal-sensors = <0x3>;
			};
		};
	};

	fragment@30 {
		target = <0xffffffff>;

		__overlay__ {
			sprd,hw-channels = <0x2 0x18cc 0x3 0x18cc 0xd 0x1854 0xf 0x1874 0x11 0x1844 0x13 0x1844 0x15 0x1864 0x1e 0x1820 0x23 0x19b8 0x27 0x19ac>;
		};
	};

	fragment@4 {
		target = <0xffffffff>;

		__overlay__ {
			clock-frequency = <0x61a80>;
			status = "okay";
			tsetup = <0x1>;

			sensor-main@20 {
				clock-names = "clk_src", "sensor_eb", "clk_96m", "clk_76m8", "clk_48m", "clk_26m";
				clocks = <0xffffffff 0x3 0xffffffff 0xc 0xffffffff 0x4 0xffffffff 0x10 0xffffffff 0x5 0xffffffff>;
				compatible = "sprd,sensor-main";
				csi = <0xffffffff>;
				phandle = <0x18>;
				power-down-gpios = <0xffffffff 0x2e 0x0>;
				reg = <0x20>;
				reset-gpios = <0xffffffff 0x2c 0x0>;
				sprd,phyid = <0x0>;
				vddcama-supply = <0xffffffff>;
				vddcamd-supply = <0xffffffff>;
				vddcammot-supply = <0xffffffff>;
				vddio-supply = <0xffffffff>;
			};
		};
	};

	fragment@5 {
		target = <0xffffffff>;

		__overlay__ {
			clock-frequency = <0x61a80>;
			status = "okay";
			tsetup = <0x1>;

			sensor-main2@20 {
				avdd-gpios = <0xffffffff 0x3e 0x0>;
				clock-names = "clk_src", "sensor_eb", "clk_96m", "clk_76m8", "clk_48m", "clk_26m";
				clocks = <0xffffffff 0x4 0xffffffff 0xb 0xffffffff 0x4 0xffffffff 0x10 0xffffffff 0x5 0xffffffff>;
				compatible = "sprd,sensor-main2";
				csi = <0xffffffff>;
				phandle = <0x1a>;
				power-down-gpios = <0xffffffff 0x3f 0x0>;
				reg = <0x20>;
				sprd,phyid = <0x4>;
				vddcama-supply = <0xffffffff>;
			};

			sensor-sub@5a {
				clock-names = "clk_src", "sensor_eb", "clk_96m", "clk_76m8", "clk_48m", "clk_26m";
				clocks = <0xffffffff 0x2 0xffffffff 0xd 0xffffffff 0x4 0xffffffff 0x10 0xffffffff 0x5 0xffffffff>;
				compatible = "sprd,sensor-sub";
				csi = <0xffffffff>;
				phandle = <0x19>;
				power-down-gpios = <0xffffffff 0x28 0x0>;
				reg = <0x5a>;
				reset-gpios = <0xffffffff 0x29 0x0>;
				sprd,phyid = <0x2>;
				vddcama-supply = <0xffffffff>;
				vddcamd-supply = <0xffffffff>;
				vddcammot-supply = <0xffffffff>;
				vddio-supply = <0xffffffff>;
			};
		};
	};

	fragment@6 {
		target = <0xffffffff>;

		__overlay__ {
			clock-frequency = <0x61a80>;
			status = "okay";
			tsetup = <0x1>;

			flash-ic@63 {
				compatible = "sprd,flash-ocp81375";
				flash-front-min-current = <0x73>;
				flash-ic = <0x13ddf>;
				flash-idx = <0x4>;
				led1-max-flash = <0x1e0>;
				led1-max-torch = <0xf0>;
				led1_default_torch = <0x9b>;
				led2-max-flash = <0x76c>;
				led2-max-torch = <0x3d4>;
				led2_default_torch = <0x78>;
				phandle = <0x1b>;
				reg = <0x63>;
			};
		};
	};

	fragment@7 {
		target = <0xffffffff>;

		__overlay__ {
			clock-frequency = <0x61a80>;
			status = "okay";
			tsetup = <0x1>;

			sensor-sub2@6e {
				avdd-gpios = <0xffffffff 0x82 0x0>;
				clock-names = "clk_src", "sensor_eb", "clk_96m", "clk_76m8", "clk_48m", "clk_26m";
				clocks = <0xffffffff 0x4 0xffffffff 0xb 0xffffffff 0x4 0xffffffff 0x10 0xffffffff 0x5 0xffffffff>;
				compatible = "sprd,sensor-sub2";
				csi = <0xffffffff>;
				phandle = <0x1c>;
				reg = <0x6e>;
				reset-gpios = <0xffffffff 0x72 0x0>;
				sprd,phyid = <0x3>;
				vddcamd-supply = <0xffffffff>;
				vddcammot-supply = <0xffffffff>;
				vddio-supply = <0xffffffff>;
			};

			sgm41516@6B {
				chg-dpdm-en = <0xffffffff 0xab 0x0>;
				chg-dpdm-sel = <0xffffffff 0xaa 0x0>;
				chg-usb-dm = <0xffffffff 0xa5 0x0>;
				compatible = "sgm41516_chg";
				dpdm-regulator = "vddldo2";
				extcon = <0xffffffff>;
				monitored-battery = <0x1>;
				phandle = <0x1d>;
				phys = <0xffffffff>;
				reg = <0x6b>;
				status = "okay";

				otg-vbus {
					phandle = <0x7>;
					regulator-name = "vddusb33";
				};
			};
		};
	};

	fragment@8 {
		target = <0xffffffff>;

		__overlay__ {
			id-gpio = <0xffffffff 0x14 0x0>;
			pinctrl-0 = <0x5>;
			pinctrl-1 = <0x6>;
			pinctrl-names = "otgpin_pull_up", "otgpin_pull_down";
		};
	};

	fragment@9 {
		target = <0xffffffff>;

		__overlay__ {

			otgpin_pull_down {
				bias-pull-down;
				phandle = <0x6>;
				pins = "QOGIRL6_KEYIN2_MISC";
			};

			otgpin_pull_up {
				bias-pull-up = <0x1>;
				phandle = <0x5>;
				pins = "QOGIRL6_KEYIN2_MISC";
			};
		};
	};
};
