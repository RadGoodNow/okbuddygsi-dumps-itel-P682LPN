/dts-v1/;

/ {
	compatible = "sprd,ums9230-14c10";
	model = "Spreadtrum UMS9230 14C10 Board";
	sprd,sc-id = "ums9230 14c10 1000";

	__fixups__ {
		adi_bus = "/fragment@24:target:0";
		aon_apb_regs = "/fragment/__overlay__/cpwcn-btwf:sprd,syscon-ap-apb:0", "/fragment/__overlay__/cpwcn-gnss:sprd,syscon-ap-apb:0";
		aon_i2c0 = "/fragment@17:target:0";
		ap_gpio = "/fragment/__overlay__/cpwcn-btwf:merlion-chip-en-gpios:0", "/fragment/__overlay__/cpwcn-btwf:merlion-rst-gpios:0", "/fragment/__overlay__/cpwcn-btwf:xtal-26m-type-sel-gpios:0", "/fragment/__overlay__/cpwcn-gnss:merlion-chip-en-gpios:0", "/fragment/__overlay__/cpwcn-gnss:merlion-rst-gpios:0", "/fragment/__overlay__/cpwcn-gnss:xtal-26m-type-sel-gpios:0", "/fragment/__overlay__/gpio-keys/key-volumedown:gpios:0", "/fragment@3/__overlay__/sensor-main@20:reset-gpios:0", "/fragment@3/__overlay__/sensor-main@20:power-down-gpios:0", "/fragment@4/__overlay__/sensor-sub@5a:reset-gpios:0", "/fragment@4/__overlay__/sensor-sub@5a:power-down-gpios:0", "/fragment@4/__overlay__/sensor-main2@20:reset-gpios:0", "/fragment@4/__overlay__/sensor-main2@20:power-down-gpios:0", "/fragment@5/__overlay__/charger@6a:charge,chg-pd-gpio:0", "/fragment@7/__overlay__/novatek@0:novatek,reset-gpio:0", "/fragment@7/__overlay__/novatek@0:novatek,irq-gpio:0", "/fragment@19/__overlay__:sprd,spk-ext-pa-gpio:0", "/fragment@22/__overlay__:avdd-gpio:0", "/fragment@22/__overlay__:avee-gpio:0", "/fragment@22/__overlay__:reset-gpio:0";
		chosen = "/fragment@0:target:0";
		csi0 = "/fragment@3/__overlay__/sensor-main@20:csi:0", "/fragment@4/__overlay__/sensor-sub@5a:csi:0";
		csi1 = "/fragment@4/__overlay__/sensor-main2@20:csi:0";
		dpu = "/fragment@23:target:0";
		dvfs_dcdc_cpu0_supply = "/fragment@8:target:0";
		dvfs_dcdc_cpu1_supply = "/fragment@9:target:0";
		eic_debounce = "/fragment@10/__overlay__:id-gpio:0";
		eic_sync = "/fragment@13/__overlay__:cd-gpios:0";
		ext_26m = "/fragment@3/__overlay__/sensor-main@20:clocks:40", "/fragment@4/__overlay__/sensor-sub@5a:clocks:40", "/fragment@4/__overlay__/sensor-main2@20:clocks:40";
		extcon_gpio = "/fragment/__overlay__/charger-manager/regulator@0/cable@0:extcon:0", "/fragment@5/__overlay__/charger@6a:extcon:0", "/fragment@10:target:0", "/fragment@11/__overlay__:extcon:0", "/fragment@12/__overlay__:extcon:0";
		hsphy = "/fragment@5/__overlay__/charger@6a:phys:0", "/fragment@11:target:0";
		i2c0 = "/fragment@3:target:0";
		i2c1 = "/fragment@4:target:0";
		i2c3 = "/fragment@15:target:0";
		i2c4 = "/fragment@16:target:0";
		i2c5 = "/fragment@5:target:0";
		i2c6 = "/fragment@6:target:0";
		ion = "/fragment@2:target:0";
		mm_clk = "/fragment@3/__overlay__/sensor-main@20:clocks:0", "/fragment@4/__overlay__/sensor-sub@5a:clocks:0", "/fragment@4/__overlay__/sensor-main2@20:clocks:0";
		mm_gate = "/fragment@3/__overlay__/sensor-main@20:clocks:8", "/fragment@4/__overlay__/sensor-sub@5a:clocks:8", "/fragment@4/__overlay__/sensor-main2@20:clocks:8";
		panel = "/fragment@22:target:0";
		pll1 = "/fragment@3/__overlay__/sensor-main@20:clocks:16", "/fragment@3/__overlay__/sensor-main@20:clocks:24", "/fragment@3/__overlay__/sensor-main@20:clocks:32", "/fragment@4/__overlay__/sensor-sub@5a:clocks:16", "/fragment@4/__overlay__/sensor-sub@5a:clocks:24", "/fragment@4/__overlay__/sensor-sub@5a:clocks:32", "/fragment@4/__overlay__/sensor-main2@20:clocks:16", "/fragment@4/__overlay__/sensor-main2@20:clocks:24", "/fragment@4/__overlay__/sensor-main2@20:clocks:32";
		pmic_eic = "/fragment/__overlay__/gpio-keys/key-volumeup:gpios:0", "/fragment/__overlay__/gpio-keys/key-power:gpios:0", "/fragment@10/__overlay__:vbus-gpio:0";
		pmic_fgu = "/fragment@21:target:0";
		pmu_apb_regs = "/fragment/__overlay__/cpwcn-btwf:sprd,syscon-ap-pmu:0", "/fragment/__overlay__/cpwcn-gnss:sprd,syscon-ap-pmu:0";
		pub_apb_regs = "/fragment/__overlay__/cpwcn-btwf:sprd,syscon-ap-pub-apb:0", "/fragment/__overlay__/cpwcn-gnss:sprd,syscon-ap-pub-apb:0";
		reserved_memory = "/fragment@1:target:0";
		sdio0 = "/fragment@13:target:0";
		sound_vbc_v4_sprd_codec = "/fragment@19:target:0";
		spi3 = "/fragment@7:target:0";
		sprd_headset = "/fragment@18:target:0";
		ufs = "/fragment@14:target:0";
		usb = "/fragment@12:target:0";
		vddcama0 = "/fragment@3/__overlay__/sensor-main@20:vddcama-supply:0";
		vddcama1 = "/fragment@4/__overlay__/sensor-sub@5a:vddcama-supply:0", "/fragment@4/__overlay__/sensor-main2@20:vddcama-supply:0";
		vddcamd0 = "/fragment@3/__overlay__/sensor-main@20:vddcamd-supply:0";
		vddcamd1 = "/fragment@4/__overlay__/sensor-sub@5a:vddcamd-supply:0", "/fragment@4/__overlay__/sensor-main2@20:vddcamd-supply:0";
		vddcamio = "/fragment@3/__overlay__/sensor-main@20:vddio-supply:0", "/fragment@4/__overlay__/sensor-sub@5a:vddio-supply:0", "/fragment@4/__overlay__/sensor-main2@20:vddio-supply:0";
		vddcammot = "/fragment@3/__overlay__/sensor-main@20:vddcammot-supply:0";
		vddldo0 = "/fragment@20:target:0";
		vddsim2 = "/fragment/__overlay__/cpwcn-btwf:dcxo1v8-supply:0", "/fragment/__overlay__/cpwcn-gnss:dcxo1v8-supply:0";
		vddusb33 = "/fragment@11/__overlay__:vdd-supply:0";
		vddwcn = "/fragment/__overlay__/cpwcn-btwf:vddwcn-supply:0", "/fragment/__overlay__/cpwcn-gnss:vddwcn-supply:0";
		vddwifipa = "/fragment/__overlay__/cpwcn-btwf:vddwifipa-supply:0";
		wcn_alpha = "/fragment/__overlay__/cpwcn-btwf:nvmem-cells:0", "/fragment/__overlay__/cpwcn-gnss:nvmem-cells:0";
		wcncp_aon_ahb_regs = "/fragment/__overlay__/cpwcn-btwf:sprd,syscon-wcn-aon-ahb:0", "/fragment/__overlay__/cpwcn-gnss:sprd,syscon-wcn-aon-ahb:0";
		wcncp_aon_apb_regs = "/fragment/__overlay__/cpwcn-btwf:sprd,syscon-wcn-aon-apb:0", "/fragment/__overlay__/cpwcn-gnss:sprd,syscon-wcn-aon-apb:0";
		wcncp_btwf_ahb_regs = "/fragment/__overlay__/cpwcn-btwf:sprd,syscon-wcn-btwf-ahb:0";
		wcncp_gnss_ahb_regs = "/fragment/__overlay__/cpwcn-gnss:sprd,syscon-wcn-gnss-ahb:0";
	};

	__local_fixups__ {

		fragment {

			__overlay__ {

				charger-manager {
					monitored-battery = <0x0>;
				};

				lcds {

					lcd_nt36005b_mipi_hd {

						display-timings {
							native-mode = <0x0>;
						};
					};
				};
			};
		};

		fragment@12 {

			__overlay__ {
				vbus-supply = <0x0>;
			};
		};

		fragment@2 {

			__overlay__ {

				heap@4 {
					memory-region = <0x0>;
				};
			};
		};

		fragment@21 {

			__overlay__ {
				monitored-battery = <0x0>;
			};
		};

		fragment@23 {

			__overlay__ {
				sprd,logo-memory = <0x0>;
				sprd,wb-memory = <0x0>;
			};
		};

		fragment@5 {

			__overlay__ {

				charger@6a {
					monitored-battery = <0x0>;
				};
			};
		};
	};

	__symbols__ {
		aw32257_charger = "/fragment@5/__overlay__/charger@6a";
		bat = "/fragment/__overlay__/battery";
		fb_reserved = "/fragment@1/__overlay__/framebuffer-mem@fd500000";
		fd_reserved = "/fragment@1/__overlay__/faceid-mem@fac50000";
		flash_ic = "/fragment@5/__overlay__/flash-ic@63";
		lcd_nt36005b_mipi_hd = "/fragment/__overlay__/lcds/lcd_nt36005b_mipi_hd";
		logo_reserved = "/fragment@1/__overlay__/logobuffer@9e000000";
		nt36005b_truly_timing0 = "/fragment/__overlay__/lcds/lcd_nt36005b_mipi_hd/display-timings/timing0";
		sensor_main = "/fragment@3/__overlay__/sensor-main@20";
		sensor_main2 = "/fragment@4/__overlay__/sensor-main2@20";
		sensor_sub = "/fragment@4/__overlay__/sensor-sub@5a";
		sipc2 = "/fragment/__overlay__/sprd-sipc/sipc@87200000";
		vddvbus = "/fragment@5/__overlay__/charger@6a/otg-vbus";
		wb_reserved = "/fragment@1/__overlay__/writeback-mem@fca50000";
		wcn_btwf = "/fragment/__overlay__/cpwcn-btwf";
		wcn_gnss = "/fragment/__overlay__/cpwcn-gnss";
		wcn_reserved = "/fragment@1/__overlay__/wcn-mem@87000000";
	};

	fragment {
		target-path = [2f 00];

		__overlay__ {

			battery {
				capacity-temp-table = <0x2d 0x64 0x19 0x64 0xa 0x62 0x0 0x5d 0xfffffff6 0x55 0xffffffec 0x40>;
				charge-cdp-current-microamp = <0x16e360 0x16e360>;
				charge-dcp-current-microamp = <0x1e8480 0x1e8480>;
				charge-full-design-microamp-hours = <0x2d0370>;
				charge-sdp-current-microamp = <0x7a120 0x7a120>;
				charge-term-current-microamp = <0x1d4c0>;
				charge-unknown-current-microamp = <0x7a120 0x7a120>;
				compatible = "simple-battery";
				constant_charge_voltage_max_microvolt = <0x423920>;
				factory-internal-resistance-micro-ohms = <0x2bf20>;
				ocv-capacity-celsius = <0x14>;
				ocv-capacity-table-0 = <0x41cfa8 0x64 0x40e930 0x5f 0x401a28 0x5a 0x3f56d8 0x55 0x3e9770 0x50 0x3df360 0x4b 0x3d2070 0x46 0x3c9f88 0x41 0x3bf790 0x3c 0x3b3c10 0x37 0x3ac2f8 0x32 0x3a6d08 0x2d 0x3a22d0 0x28 0x39e838 0x23 0x39b188 0x1e 0x397308 0x19 0x3928d0 0x14 0x38cb10 0xf 0x385db0 0xa 0x382ed0 0x5 0x33e140 0x0>;
				phandle = <0x2>;
				resistance-temp-table = <0x2d 0x4d 0x19 0x64 0xa 0x222 0x0 0x301 0xfffffff6 0x37c 0xffffffec 0x39b>;
				voltage-min-design-microvolt = <0x34a490>;
			};

			charger-manager {
				cm-battery-cold = <0xc8>;
				cm-battery-cold-in-minus;
				cm-battery-hot = <0x320>;
				cm-battery-stat = <0x2>;
				cm-battery-temp-diff = <0x64>;
				cm-cap-remap-table = <0x1 0x2 0x3 0x2 0x3 0x2 0x62 0x63 0x2 0x63 0x64 0x3>;
				cm-capacity-track;
				cm-cdp-jeita-temp-table = <0x3e8 0x406 0x0 0x432380 0x47e 0x49c 0xaae60 0x432380 0x5aa 0x58c 0x16e360 0x432380 0x640 0x622 0xaae60 0x3e8fa0>;
				cm-charge-voltage-drop = <0xaae60>;
				cm-charge-voltage-max = <0x632ea0>;
				cm-chargers = "aw32257";
				cm-charging-max = <0x1499700>;
				cm-dcp-jeita-temp-table = <0x3e8 0x406 0x0 0x432380 0x47e 0x49c 0xaae60 0x432380 0x5aa 0x58c 0x1e8480 0x432380 0x640 0x622 0xaae60 0x3e8fa0>;
				cm-discharging-max = <0x2932e0>;
				cm-fuel-gauge = "sc27xx-fgu";
				cm-fullbatt-capacity = <0x64>;
				cm-fullbatt-current = <0x1d4c0>;
				cm-fullbatt-vchkdrop-ms = <0x7530>;
				cm-fullbatt-vchkdrop-volt = <0xea60>;
				cm-fullbatt-voltage = <0x419ce0>;
				cm-name = "battery";
				cm-num-chargers = <0x1>;
				cm-one-cap-time = <0x1e>;
				cm-poll-interval = <0x3a98>;
				cm-poll-mode = <0x2>;
				cm-sdp-jeita-temp-table = <0x3e8 0x406 0x0 0x432380 0x47e 0x49c 0x7a120 0x432380 0x5aa 0x58c 0x7a120 0x432380 0x640 0x622 0x7a120 0x3e8fa0>;
				cm-shutdown-voltage = <0x2f4d60>;
				cm-tickle-time-out = <0x5dc>;
				cm-unknown-jeita-temp-table = <0x3e8 0x406 0x0 0x432380 0x47e 0x49c 0x7a120 0x432380 0x5aa 0x58c 0x7a120 0x432380 0x640 0x622 0x7a120 0x3e8fa0>;
				compatible = "charger-manager";
				monitored-battery = <0x2>;

				regulator@0 {
					cm-regulator-name = "vddgen0";

					cable@0 {
						cm-cable-name = "USB";
						extcon = <0xffffffff>;
					};
				};
			};

			cpwcn-btwf {
				#address-cells = <0x1>;
				compatible = "sprd,integrate_marlin";
				dcxo1v8-supply = <0xffffffff>;
				merlion-chip-en-gpios = <0xffffffff 0x76 0x0>;
				merlion-rst-gpios = <0xffffffff 0x75 0x0>;
				nvmem-cell-names = "wcn_efuse_blk0";
				nvmem-cells = <0xffffffff>;
				phandle = <0x8>;
				reg = <0x0 0x87000000 0x0 0x200000>;
				sprd,apcp-sync-addr = <0x7fdc00>;
				sprd,ctrl-mask = <0x3fff 0x2000000 0x80 0x1000000 0x40000000 0x100f 0x55 0x3000000 0xffffffff 0x55>;
				sprd,ctrl-probe-num = <0x1>;
				sprd,ctrl-reg = <0x9018 0x23a8 0x2818 0x23a8 0x90 0x98 0xc 0x1410 0x4c 0xc>;
				sprd,ctrl-rw-offset = <0x1000 0x2000 0x2000 0x2000 0x0 0x0 0x0 0x1000 0x0 0x0>;
				sprd,ctrl-shutdown-mask = <0x1000>;
				sprd,ctrl-shutdown-reg = <0x98>;
				sprd,ctrl-shutdown-rw-offset = <0x0>;
				sprd,ctrl-shutdown-type = <0xa>;
				sprd,ctrl-shutdown-us-delay = <0xa>;
				sprd,ctrl-shutdown-value = <0x1000>;
				sprd,ctrl-type = <0x2 0x1 0x1 0x1 0xa 0xa 0x9 0x7 0x9 0x9>;
				sprd,ctrl-us-delay = <0x3e8 0x3e8 0x3e8 0x7d0 0x3e8 0x3e8 0x3e8 0x3e8 0x3e8 0x3e8>;
				sprd,ctrl-value = <0x70 0x2000000 0x80 0x1000000 0x40000000 0x0 0x55 0x3000000 0x7fdc00 0x0>;
				sprd,file-length = <0x200000>;
				sprd,file-name = "/dev/block/platform/soc/soc:ap-apb/201d0000.sdio/by-name/wcnmodem";
				sprd,file-name-ufs = "/dev/block/platform/soc/soc:ap-apb/20200000.ufs/by-name/wcnmodem";
				sprd,name = "wcn_btwf";
				sprd,syscon-ap-apb = <0xffffffff>;
				sprd,syscon-ap-pmu = <0xffffffff>;
				sprd,syscon-ap-pub-apb = <0xffffffff>;
				sprd,syscon-wcn-aon-ahb = <0xffffffff>;
				sprd,syscon-wcn-aon-apb = <0xffffffff>;
				sprd,syscon-wcn-btwf-ahb = <0xffffffff>;
				sprd,wcn-sipc-ver = <0x1>;
				vddwcn-supply = <0xffffffff>;
				vddwifipa-supply = <0xffffffff>;
				xtal-26m-type-sel-gpios = <0xffffffff 0xad 0x0>;
			};

			cpwcn-gnss {
				#address-cells = <0x1>;
				#size-cells = <0x1>;
				compatible = "sprd,integrate_gnss";
				dcxo1v8-supply = <0xffffffff>;
				merlion-chip-en-gpios = <0xffffffff 0x76 0x0>;
				merlion-rst-gpios = <0xffffffff 0x75 0x0>;
				nvmem-cell-names = "gnss_efuse_blk0";
				nvmem-cells = <0xffffffff>;
				phandle = <0x9>;
				reg = <0x0 0x87600000 0x0 0x180000>;
				sprd,apcp-sync-addr = <0x1ffc00>;
				sprd,ctrl-mask = <0x3fff 0x2000000 0x80 0x1000000 0x40000000 0x100f 0x22 0x1ffffff 0xffffffff 0x22>;
				sprd,ctrl-probe-num = <0x1>;
				sprd,ctrl-reg = <0x9018 0x23a8 0x2818 0x23a8 0x90 0xc8 0xc 0x1404 0x50 0xc>;
				sprd,ctrl-rw-offset = <0x1000 0x2000 0x2000 0x2000 0x0 0x0 0x0 0x1000 0x0 0x0>;
				sprd,ctrl-shutdown-mask = <0x1000>;
				sprd,ctrl-shutdown-reg = <0xc8>;
				sprd,ctrl-shutdown-rw-offset = <0x0>;
				sprd,ctrl-shutdown-type = <0xa>;
				sprd,ctrl-shutdown-us-delay = <0xa>;
				sprd,ctrl-shutdown-value = <0x1000>;
				sprd,ctrl-type = <0x2 0x1 0x1 0x1 0xa 0xa 0x9 0x8 0x9 0x9>;
				sprd,ctrl-us-delay = <0x3e8 0x3e8 0x3e8 0x7d0 0x3e8 0x3e8 0x3e8 0x3e8 0x3e8 0x3e8>;
				sprd,ctrl-value = <0x70 0x2000000 0x80 0x1000000 0x40000000 0x0 0x22 0x1600000 0x1ffc00 0x0>;
				sprd,file-length = <0x180000>;
				sprd,file-name = "/dev/block/platform/soc/soc:ap-apb/201d0000.sdio/by-name/gnssmodem";
				sprd,file-name-ext = "/dev/block/platform/soc/soc:ap-apb/201d0000.sdio/by-name/gnssmodem";
				sprd,file-name-ext-ufs = "/dev/block/platform/soc/soc:ap-apb/20200000.ufs/by-name/gnssmodem";
				sprd,file-name-ufs = "/dev/block/platform/soc/soc:ap-apb/20200000.ufs/by-name/gnssmodem";
				sprd,name = "wcn_gnss";
				sprd,syscon-ap-apb = <0xffffffff>;
				sprd,syscon-ap-pmu = <0xffffffff>;
				sprd,syscon-ap-pub-apb = <0xffffffff>;
				sprd,syscon-wcn-aon-ahb = <0xffffffff>;
				sprd,syscon-wcn-aon-apb = <0xffffffff>;
				sprd,syscon-wcn-gnss-ahb = <0xffffffff>;
				sprd,wcn-sipc-ver = <0x1>;
				vddwcn-supply = <0xffffffff>;
				xtal-26m-type-sel-gpios = <0xffffffff 0xad 0x0>;
			};

			gnss_common_ctl {
				compatible = "sprd,gnss_common_ctl";
				sprd,name = "gnss_common_ctl";
			};

			gpio-keys {
				compatible = "gpio-keys";

				key-power {
					debounce-interval = <0x2>;
					gpios = <0xffffffff 0x1 0x1>;
					label = "Power Key";
					linux,code = <0x74>;
					wakeup-source;
				};

				key-volumedown {
					debounce-interval = <0x2>;
					gpios = <0xffffffff 0x7c 0x1>;
					label = "Volume Down Key";
					linux,code = <0x72>;
					wakeup-source;
				};

				key-volumeup {
					debounce-interval = <0x2>;
					gpios = <0xffffffff 0x4 0x0>;
					label = "Volume Up Key";
					linux,code = <0x73>;
					wakeup-source;
				};
			};

			lcds {

				lcd_nt36005b_mipi_hd {
					phandle = <0x7>;
					sprd,dsi-color-format = "rgb888";
					sprd,dsi-lane-number = <0x3>;
					sprd,dsi-work-mode = <0x1>;
					sprd,initial-command = <0x23000002 0xff202300 0x2fb01 0x23000002 0x1552300 0x20355 0x23000002 0x5912300 0x2074b 0x23000002 0x8cb2300 0x20e69 0x23000002 0xf692300 0x294c0 0x23000002 0x95092300 0x29609 0x23000002 0x69912300 0x21f02 0x23000002 0xff202300 0x2fb01 0x39000011 0xb0000800 0x9002d00 0x41005300 0x65007400 0x83390000 0x11b10091 0xc500ed 0x1310164 0x1b801f9 0x1fc3900 0x11b202 0x3c028302 0xb302ec03 0x14034103 0x53036239 0xdb3 0x376038c 0x3a603c0 0x3cf03d1 0x39000011 0xb4000800 0x9002d00 0x41005300 0x65007400 0x83390000 0x11b50091 0xc500ed 0x1310164 0x1b801f9 0x1fc3900 0x11b602 0x3c028302 0xb302ec03 0x14034103 0x53036239 0xdb7 0x376038c 0x3a603c0 0x3cf03d1 0x39000011 0xb8000800 0x9002d00 0x41005300 0x65007400 0x83390000 0x11b90091 0xc500ed 0x1310164 0x1b801f9 0x1fc3900 0x11ba02 0x3c028302 0xb302ec03 0x14034103 0x53036239 0xdbb 0x376038c 0x3a603c0 0x3cf03d1 0x23000002 0xff212300 0x2fb01 0x39000011 0xb0000000 0x1002500 0x39004b00 0x5d006c00 0x7b390000 0x11b10089 0xbd00e5 0x129015c 0x1b001f1 0x1f43900 0x11b202 0x34027b02 0xab02e403 0xc033903 0x4b035a39 0xdb3 0x36e0384 0x39e03b8 0x3c703c9 0x39000011 0xb4000000 0x1002500 0x39004b00 0x5d006c00 0x7b390000 0x11b50089 0xbd00e5 0x129015c 0x1b001f1 0x1f43900 0x11b602 0x34027b02 0xab02e403 0xc033903 0x4b035a39 0xdb7 0x36e0384 0x39e03b8 0x3c703c9 0x39000011 0xb8000000 0x1002500 0x39004b00 0x5d006c00 0x7b390000 0x11b90089 0xbd00e5 0x129015c 0x1b001f1 0x1f43900 0x11ba02 0x34027b02 0xab02e403 0xc033903 0x4b035a39 0xdbb 0x36e0384 0x39e03b8 0x3c703c9 0x23000002 0xff232300 0x2fb01 0x23000002 0x12b92300 0x215e3 0x23000002 0x160b2300 0x2ff24 0x23000002 0xfb012300 0x2930a 0x23000002 0x94122300 0x20000 0x23000002 0x11e2300 0x2021e 0x23000002 0x31f2300 0x2041f 0x23000002 0x51d2300 0x2061d 0x23000002 0x7062300 0x2080c 0x23000002 0x90c2300 0x20a0d 0x23000002 0xb0d2300 0x20c0e 0x23000002 0xd0e2300 0x20e0f 0x23000002 0xf0f2300 0x21021 0x23000002 0x11212300 0x2121c 0x23000002 0x131c2300 0x21404 0x23000002 0x15052300 0x21600 0x23000002 0x171e2300 0x2181e 0x23000002 0x191f2300 0x21a1f 0x23000002 0x1b1d2300 0x21c1d 0x23000002 0x1d072300 0x21e0c 0x23000002 0x1f0c2300 0x2200d 0x23000002 0x210d2300 0x2220e 0x23000002 0x230e2300 0x2240f 0x23000002 0x250f2300 0x22621 0x23000002 0x27212300 0x2281c 0x23000002 0x291c2300 0x22a04 0x23000002 0x2b052300 0x22d0c 0x23000002 0x41442300 0x24243 0x23000002 0x45432300 0x24644 0x23000002 0x47442300 0x24844 0x23000002 0x49002300 0x24a24 0x23000002 0x4b912300 0x24c54 0x23000002 0x2f0a2300 0x23008 0x23000002 0x310e2300 0x2320f 0x23000002 0x33082300 0x2340a 0x23000002 0x350f2300 0x2360e 0x23000002 0x37442300 0x23844 0x23000002 0x39002300 0x23a65 0x23000002 0x3b8a2300 0x23d54 0x23000002 0x4d342300 0x24e12 0x23000002 0x4f002300 0x25000 0x23000002 0x51212300 0x25243 0x23000002 0x53002300 0x25400 0x23000002 0x55472300 0x25644 0x23000002 0x58212300 0x25900 0x23000002 0x5a652300 0x25b8a 0x23000002 0x5c882300 0x25d08 0x23000002 0x5e042300 0x25f00 0x23000002 0x60802300 0x2619a 0x23000002 0x64102300 0x2800f 0x23000002 0x81092300 0x2820f 0x23000002 0x83092300 0x28480 0x23000002 0x85012300 0x28604 0x23000002 0x88402300 0x289c8 0x23000002 0x8a882300 0x28d08 0x23000002 0x8e082300 0x29140 0x23000002 0x92ae2300 0x29880 0x23000002 0xab002300 0x2ad00 0x23000002 0xaf042300 0x2b005 0x23000002 0xb1aa2300 0x2ff25 0x23000002 0xfb012300 0x21782 0x23000002 0x18062300 0x2190f 0x23000002 0xc0072300 0x2c284 0x23000002 0xc6922300 0x2ca1c 0x23000002 0xcb1c2300 0x2cc1c 0x23000002 0xcd002300 0x2ce00 0x23000002 0xd3112300 0x2d4cc 0x23000002 0xd5112300 0x2d61c 0x23000002 0xd7112300 0x20a82 0x23000002 0xb172300 0x20c01 0x23000002 0xff262300 0x2fb01 0x23000002 0xa02300 0x2ff27 0x23000002 0xfb012300 0x21300 0x23000002 0x15b42300 0x21f55 0x23000002 0x260f2300 0x2c018 0x23000002 0xc1f82300 0x2c703 0x23000002 0xc2002300 0x2c300 0x23000002 0xc4f82300 0x2c500 0x23000002 0xc6002300 0x2ffd0 0x23000002 0xfb012300 0x20507 0x23000002 0x9f02300 0x22870 0x23000002 0xff102300 0x2fb01 0x23000002 0x53242300 0x25501 0x23000002 0xba022300 0x23500 0x23780002 0x11002314 0x22900>;
					sprd,phy-bit-clock = <0xdb3d0>;
					sprd,phy-escape-clock = <0x4e20>;
					sprd,reset-off-sequence = <0x1 0x1>;
					sprd,reset-on-sequence = <0x1 0x5 0x0 0x5 0x1 0x5 0x0 0x5 0x1 0x14>;
					sprd,sleep-in-command = [13 14 00 01 28 13 78 00 01 10];
					sprd,sleep-out-command = [13 78 00 01 11 13 14 00 01 29];

					display-timings {
						native-mode = <0x1>;

						timing0 {
							clock-frequency = <0x5b8d800>;
							hactive = <0x2d0>;
							hback-porch = <0x3c>;
							hfront-porch = <0x44>;
							hsync-len = <0x8>;
							phandle = <0x1>;
							vactive = <0x668>;
							vback-porch = <0x108>;
							vfront-porch = <0xa>;
							vsync-len = <0x2>;
						};
					};

					oled-backlight {
						brightness-levels = [23 00 00 02 51 00 23 00 00 02 51 02 23 00 00 02 51 02 23 00 00 02 51 02 23 00 00 02 51 02 23 00 00 02 51 02 23 00 00 02 51 03 23 00 00 02 51 03 23 00 00 02 51 04 23 00 00 02 51 05 23 00 00 02 51 07 23 00 00 02 51 09 23 00 00 02 51 0a 23 00 00 02 51 0b 23 00 00 02 51 0c 23 00 00 02 51 0d 23 00 00 02 51 0e 23 00 00 02 51 0f 23 00 00 02 51 10 23 00 00 02 51 11 23 00 00 02 51 12 23 00 00 02 51 13 23 00 00 02 51 14 23 00 00 02 51 15 23 00 00 02 51 16 23 00 00 02 51 17 23 00 00 02 51 18 23 00 00 02 51 19 23 00 00 02 51 1a 23 00 00 02 51 1b 23 00 00 02 51 1c 23 00 00 02 51 1d 23 00 00 02 51 1e 23 00 00 02 51 1f 23 00 00 02 51 20 23 00 00 02 51 21 23 00 00 02 51 22 23 00 00 02 51 23 23 00 00 02 51 24 23 00 00 02 51 25 23 00 00 02 51 26 23 00 00 02 51 27 23 00 00 02 51 28 23 00 00 02 51 29 23 00 00 02 51 2a 23 00 00 02 51 2b 23 00 00 02 51 2c 23 00 00 02 51 2d 23 00 00 02 51 2e 23 00 00 02 51 2f 23 00 00 02 51 30 23 00 00 02 51 31 23 00 00 02 51 32 23 00 00 02 51 33 23 00 00 02 51 34 23 00 00 02 51 35 23 00 00 02 51 36 23 00 00 02 51 37 23 00 00 02 51 38 23 00 00 02 51 39 23 00 00 02 51 3a 23 00 00 02 51 3b 23 00 00 02 51 3c 23 00 00 02 51 3d 23 00 00 02 51 3e 23 00 00 02 51 3f 23 00 00 02 51 40 23 00 00 02 51 41 23 00 00 02 51 42 23 00 00 02 51 43 23 00 00 02 51 44 23 00 00 02 51 45 23 00 00 02 51 46 23 00 00 02 51 47 23 00 00 02 51 48 23 00 00 02 51 49 23 00 00 02 51 4a 23 00 00 02 51 4b 23 00 00 02 51 4c 23 00 00 02 51 4d 23 00 00 02 51 4e 23 00 00 02 51 4f 23 00 00 02 51 50 23 00 00 02 51 51 23 00 00 02 51 52 23 00 00 02 51 53 23 00 00 02 51 54 23 00 00 02 51 55 23 00 00 02 51 56 23 00 00 02 51 57 23 00 00 02 51 58 23 00 00 02 51 59 23 00 00 02 51 5a 23 00 00 02 51 5b 23 00 00 02 51 5c 23 00 00 02 51 5d 23 00 00 02 51 5e 23 00 00 02 51 5f 23 00 00 02 51 60 23 00 00 02 51 61 23 00 00 02 51 62 23 00 00 02 51 63 23 00 00 02 51 64 23 00 00 02 51 65 23 00 00 02 51 66 23 00 00 02 51 67 23 00 00 02 51 68 23 00 00 02 51 69 23 00 00 02 51 6a 23 00 00 02 51 6b 23 00 00 02 51 6c 23 00 00 02 51 6d 23 00 00 02 51 6e 23 00 00 02 51 6f 23 00 00 02 51 70 23 00 00 02 51 71 23 00 00 02 51 72 23 00 00 02 51 73 23 00 00 02 51 74 23 00 00 02 51 75 23 00 00 02 51 76 23 00 00 02 51 77 23 00 00 02 51 78 23 00 00 02 51 79 23 00 00 02 51 7a 23 00 00 02 51 7b 23 00 00 02 51 7c 23 00 00 02 51 7d 23 00 00 02 51 7e 23 00 00 02 51 7f 23 00 00 02 51 80 23 00 00 02 51 81 23 00 00 02 51 82 23 00 00 02 51 83 23 00 00 02 51 84 23 00 00 02 51 85 23 00 00 02 51 86 23 00 00 02 51 87 23 00 00 02 51 88 23 00 00 02 51 89 23 00 00 02 51 8a 23 00 00 02 51 8b 23 00 00 02 51 8c 23 00 00 02 51 8d 23 00 00 02 51 8e 23 00 00 02 51 8f 23 00 00 02 51 90 23 00 00 02 51 91 23 00 00 02 51 92 23 00 00 02 51 93 23 00 00 02 51 94 23 00 00 02 51 95 23 00 00 02 51 96 23 00 00 02 51 97 23 00 00 02 51 98 23 00 00 02 51 99 23 00 00 02 51 9a 23 00 00 02 51 9b 23 00 00 02 51 9c 23 00 00 02 51 9d 23 00 00 02 51 9e 23 00 00 02 51 9f 23 00 00 02 51 a0 23 00 00 02 51 a1 23 00 00 02 51 a2 23 00 00 02 51 a3 23 00 00 02 51 a4 23 00 00 02 51 a5 23 00 00 02 51 a6 23 00 00 02 51 a7 23 00 00 02 51 a8 23 00 00 02 51 a9 23 00 00 02 51 aa 23 00 00 02 51 ab 23 00 00 02 51 ac 23 00 00 02 51 ad 23 00 00 02 51 ae 23 00 00 02 51 af 23 00 00 02 51 b0 23 00 00 02 51 b1 23 00 00 02 51 b2 23 00 00 02 51 b3 23 00 00 02 51 b4 23 00 00 02 51 b5 23 00 00 02 51 b6 23 00 00 02 51 b7 23 00 00 02 51 b8 23 00 00 02 51 b9 23 00 00 02 51 ba 23 00 00 02 51 bb 23 00 00 02 51 bc 23 00 00 02 51 bd 23 00 00 02 51 be 23 00 00 02 51 bf 23 00 00 02 51 c0 23 00 00 02 51 c1 23 00 00 02 51 c2 23 00 00 02 51 c3 23 00 00 02 51 c4 23 00 00 02 51 c5 23 00 00 02 51 c6 23 00 00 02 51 c7 23 00 00 02 51 c8 23 00 00 02 51 c9 23 00 00 02 51 ca 23 00 00 02 51 cb 23 00 00 02 51 cc 23 00 00 02 51 cd 23 00 00 02 51 ce 23 00 00 02 51 cf 23 00 00 02 51 d0 23 00 00 02 51 d1 23 00 00 02 51 d2 23 00 00 02 51 d3 23 00 00 02 51 d4 23 00 00 02 51 d5 23 00 00 02 51 d6 23 00 00 02 51 d7 23 00 00 02 51 d8 23 00 00 02 51 d9 23 00 00 02 51 da 23 00 00 02 51 db 23 00 00 02 51 dc 23 00 00 02 51 dd 23 00 00 02 51 de 23 00 00 02 51 df 23 00 00 02 51 e0 23 00 00 02 51 e1 23 00 00 02 51 e2 23 00 00 02 51 e3 23 00 00 02 51 e4 23 00 00 02 51 e5 23 00 00 02 51 e6 23 00 00 02 51 e7 23 00 00 02 51 e8 23 00 00 02 51 e9 23 00 00 02 51 ea 23 00 00 02 51 eb 23 00 00 02 51 ec 23 00 00 02 51 ed 23 00 00 02 51 ee 23 00 00 02 51 ef 23 00 00 02 51 f0 23 00 00 02 51 f1 23 00 00 02 51 f2 23 00 00 02 51 f3 23 00 00 02 51 f4 23 00 00 02 51 f5 23 00 00 02 51 f6 23 00 00 02 51 f7 23 00 00 02 51 f8 23 00 00 02 51 f9 23 00 00 02 51 fa 23 00 00 02 51 fb 23 00 00 02 51 fc 23 00 00 02 51 fd 23 00 00 02 51 fe];
						default-brightness-level = <0x21>;
						sprd,max-level = <0xff>;
					};
				};
			};

			sprd-sipc {
				compatible = "sprd,sipc";

				sipc@87200000 {
					phandle = <0xa>;
					sprd,dst = <0x3 0x8>;
					sprd,name = "sipc-wcn";
					sprd,smem-info = <0x87200000 0x200000 0x180000>;
				};
			};

			sprd-wlan {
				compatible = "sprd,sc2355-wifi";
				reg = <0x0 0x87380000 0x0 0x280000>;
			};

			wcn_bt {
				compatible = "sprd,wcn_internal_chip";
				sprd,channel = <0x4>;
				sprd,dst = <0x3>;
				sprd,name = "ttyBT";
				sprd,rx_bufid = <0xa>;
				sprd,tx_bufid = <0xb>;
			};

			wcn_fm {
				compatible = "sprd,wcn_fm_internal_chip";
				sprd,dst = <0x3>;
				sprd,name = "fm";
				sprd,rx_bufid = <0xd>;
				sprd,rx_channel = <0x4>;
				sprd,tx_bufid = <0xe>;
				sprd,tx_channel = <0x4>;
			};
		};
	};

	fragment@0 {
		target = <0xffffffff>;

		__overlay__ {
			bootargs_ext = "androidboot.hardware=ums9230_14c10 androidboot.dtbo_idx=0";
		};
	};

	fragment@1 {
		target = <0xffffffff>;

		__overlay__ {

			faceid-mem@fac50000 {
				phandle = <0x3>;
				reg = <0x0 0xfac50000 0x0 0x1e00000>;
			};

			framebuffer-mem@fd500000 {
				phandle = <0xc>;
				reg = <0x0 0xfd500000 0x0 0x2a80000>;
			};

			logobuffer@9e000000 {
				phandle = <0x5>;
				reg = <0x0 0x9e000000 0x0 0xab0000>;
			};

			wcn-mem@87000000 {
				phandle = <0xb>;
				reg = <0x0 0x87000000 0x0 0x800000>;
			};

			writeback-mem@fca50000 {
				phandle = <0x6>;
				reg = <0x0 0xfca50000 0x0 0xab0000>;
			};
		};
	};

	fragment@10 {
		target = <0xffffffff>;

		__overlay__ {
			compatible = "linux,extcon-usb-gpio";
			id-gpio = <0xffffffff 0x14 0x0>;
			vbus-gpio = <0xffffffff 0x0 0x0>;
		};
	};

	fragment@11 {
		target = <0xffffffff>;

		__overlay__ {
			extcon = <0xffffffff>;
			sprd,hsphy-device-eye-pattern = <0x4f3d1c0>;
			sprd,hsphy-host-eye-pattern = <0x4f3d1c0>;
			status = "okay";
			vdd-supply = <0xffffffff>;
		};
	};

	fragment@12 {
		target = <0xffffffff>;

		__overlay__ {
			extcon = <0xffffffff>;
			status = "okay";
			vbus-supply = <0x4>;
		};
	};

	fragment@13 {
		target = <0xffffffff>;

		__overlay__ {
			cd-gpios = <0xffffffff 0x23 0x0>;
		};
	};

	fragment@14 {
		target = <0xffffffff>;

		__overlay__ {
			status = "okay";
		};
	};

	fragment@15 {
		target = <0xffffffff>;

		__overlay__ {
			status = "okay";
		};
	};

	fragment@16 {
		target = <0xffffffff>;

		__overlay__ {
			status = "okay";
		};
	};

	fragment@17 {
		target = <0xffffffff>;

		__overlay__ {
			clock-frequency = <0xf4240>;
			status = "okay";
		};
	};

	fragment@18 {
		target = <0xffffffff>;

		__overlay__ {
			status = "okay";
		};
	};

	fragment@19 {
		target = <0xffffffff>;

		__overlay__ {
			sprd,spk-ext-pa-gpio = <0xffffffff 0x8b 0x0>;
			sprd,spk-ext-pa-info = <0x0 0x0 0x2 0x0>;
			sprd-audio-card,routing = "HPMIC Pin", "HP Mic Jack", "MIC Pin", "Mic Jack", "MIC2 Pin", "Aux Mic Jack", "HeadPhone Jack", "HP Pin", "Ext Spk", "HP Pin", "Ext Spk1", "HP Pin", "Ext Spk", "SPK Pin", "Ext Spk1", "SPK Pin", "UCP1301 SPK ON", "SPK Pin", "Ext Spk", "UCP1301 SPK", "PDM DMIC2 ON", "SPK Pin", "Ext Spk", "PDM_DMIC2", "DMIC Pin", "DMic Jack", "DMIC1 Pin", "DMic1 Jack", "Ext Ear", "EAR Pin", "Ext Ear", "SPK Pin", "Ext Ear", "HP Pin", "UCP1301 RCV ON", "EAR Pin", "Ext Ear", "UCP1301 RCV";
			status = "okay";
		};
	};

	fragment@2 {
		target = <0xffffffff>;

		__overlay__ {

			heap@4 {
				label = "carveout_fd";
				memory-region = <0x3>;
				reg = <0x4>;
				type = <0x2>;
			};
		};
	};

	fragment@20 {
		target = <0xffffffff>;

		__overlay__ {
			regulator-always-on;
		};
	};

	fragment@21 {
		target = <0xffffffff>;

		__overlay__ {
			first-calib-capacity = <0x32>;
			first-calib-voltage = <0x36a060>;
			monitored-battery = <0x2>;
			sprd,calib-resistance-real = <0x12f2>;
			sprd,calib-resistance-spec = <0x4e20>;
		};
	};

	fragment@22 {
		target = <0xffffffff>;

		__overlay__ {
			avdd-gpio = <0xffffffff 0x87 0x0>;
			avee-gpio = <0xffffffff 0x88 0x0>;
			reset-gpio = <0xffffffff 0x32 0x0>;
		};
	};

	fragment@23 {
		target = <0xffffffff>;

		__overlay__ {
			sprd,logo-memory = <0x5>;
			sprd,wb-memory = <0x6>;
		};
	};

	fragment@24 {
		target = <0xffffffff>;

		__overlay__ {
			sprd,hw-channels = <0x2 0x18cc 0x3 0x18cc 0xd 0x1854 0xf 0x1874 0x11 0x1844 0x13 0x1844 0x15 0x1864 0x1e 0x1820 0x23 0x19b8 0x27 0x19ac>;
		};
	};

	fragment@3 {
		target = <0xffffffff>;

		__overlay__ {
			clock-frequency = <0x61a80>;
			status = "okay";

			sensor-main@20 {
				clock-names = "clk_src", "sensor_eb", "clk_96m", "clk_76m8", "clk_48m", "clk_26m";
				clocks = <0xffffffff 0x3 0xffffffff 0xc 0xffffffff 0x4 0xffffffff 0x10 0xffffffff 0x5 0xffffffff>;
				compatible = "sprd,sensor-main";
				csi = <0xffffffff>;
				phandle = <0xd>;
				power-down-gpios = <0xffffffff 0x2e 0x0>;
				reg = <0x20>;
				reset-gpios = <0xffffffff 0x2c 0x0>;
				sprd,phyid = <0x0>;
				vddcama-supply = <0xffffffff>;
				vddcamd-supply = <0xffffffff>;
				vddcammot-supply = <0xffffffff>;
				vddio-supply = <0xffffffff>;
			};
		};
	};

	fragment@4 {
		target = <0xffffffff>;

		__overlay__ {
			clock-frequency = <0x61a80>;
			status = "okay";

			sensor-main2@20 {
				clock-names = "clk_src", "sensor_eb", "clk_96m", "clk_76m8", "clk_48m", "clk_26m";
				clocks = <0xffffffff 0x2 0xffffffff 0xd 0xffffffff 0x4 0xffffffff 0x10 0xffffffff 0x5 0xffffffff>;
				compatible = "sprd,sensor-main2";
				csi = <0xffffffff>;
				phandle = <0xf>;
				power-down-gpios = <0xffffffff 0x2f 0x0>;
				reg = <0x20>;
				reset-gpios = <0xffffffff 0x2d 0x0>;
				sprd,phyid = <0x4>;
				vddcama-supply = <0xffffffff>;
				vddcamd-supply = <0xffffffff>;
				vddio-supply = <0xffffffff>;
			};

			sensor-sub@5a {
				clock-names = "clk_src", "sensor_eb", "clk_96m", "clk_76m8", "clk_48m", "clk_26m";
				clocks = <0xffffffff 0x2 0xffffffff 0xd 0xffffffff 0x4 0xffffffff 0x10 0xffffffff 0x5 0xffffffff>;
				compatible = "sprd,sensor-sub";
				csi = <0xffffffff>;
				phandle = <0xe>;
				power-down-gpios = <0xffffffff 0x28 0x0>;
				reg = <0x5a>;
				reset-gpios = <0xffffffff 0x29 0x0>;
				sprd,phyid = <0x2>;
				vddcama-supply = <0xffffffff>;
				vddcamd-supply = <0xffffffff>;
				vddio-supply = <0xffffffff>;
			};
		};
	};

	fragment@5 {
		target = <0xffffffff>;

		__overlay__ {
			clock-frequency = <0x61a80>;
			status = "okay";

			charger@6a {
				charge,chg-pd-gpio = <0xffffffff 0x79 0x0>;
				compatible = "aw32257";
				cv_val = <0x2b>;
				extcon = <0xffffffff>;
				max_cv = <0x48>;
				monitored-battery = <0x2>;
				phandle = <0x10>;
				phys = <0xffffffff>;
				reg = <0x6a>;
				ti,battery-regulation-voltage = <0x1130>;
				ti,charge-current = <0x9eb10>;
				ti,current-limit = <0x186a0>;
				ti,resistor-sense = <0x38>;
				ti,termination-current = <0x2bf20>;
				ti,weak-battery-voltage = <0xd48>;

				otg-vbus {
					phandle = <0x4>;
					regulator-name = "vddvbus";
				};
			};

			flash-ic@63 {
				compatible = "sprd,flash-aw36515";
				phandle = <0x11>;
				reg = <0x63>;
				sprd,flash-ic = <0x8ea3>;
			};
		};
	};

	fragment@6 {
		target = <0xffffffff>;

		__overlay__ {
			clock-frequency = <0x61a80>;
			status = "okay";
		};
	};

	fragment@7 {
		target = <0xffffffff>;

		__overlay__ {
			status = "ok";

			novatek@0 {
				compatible = "novatek,NVT-ts-spi";
				novatek,irq-gpio = <0xffffffff 0x90 0x0>;
				novatek,reset-gpio = <0xffffffff 0x91 0x0>;
				novatek,spi-rd-fast-addr = <0x3f310>;
				novatek,swrst-n8-addr = <0x3f0fe>;
				reg = <0x0>;
				spi-max-frequency = <0x927c00>;

				novatek-mp-criteria-nvtpid@0 {
					#address-cells = <0x1>;
					#size-cells = <0x0>;
					AIN_KEY = <0x0 0x1 0x2 0xff>;
					AIN_X = <0x0 0x1 0x2 0x3 0x4 0x5 0x6 0x7 0x8 0x9 0xa 0xb 0xc 0xd 0xe 0xf 0x10 0x11>;
					AIN_Y = <0x0 0x1 0x2 0x3 0x4 0x5 0x6 0x7 0x8 0x9 0xa 0xb 0xc 0xd 0xe 0xf 0x10 0x11 0x12 0x13 0x14 0x15 0x16 0x17 0x18 0x19 0x1a 0x1b 0x1c 0x1d 0x1e 0x1f 0x20 0x21 0x22 0x23>;
					IC_KEY_CFG_SIZE = <0x4>;
					IC_X_CFG_SIZE = <0x12>;
					IC_Y_CFG_SIZE = <0x24>;
					PS_Config_Diff_Test_Frame = <0x32>;
					PS_Config_Lmt_FW_CC_N = <0x0 0x0 0x0 0x0 0x0 0x0 0x0 0x0 0x0 0x0 0x0 0x0 0x0 0x0 0x0 0x0 0x0 0x0 0x0 0x0 0x0 0x0 0x0 0x0 0x0 0x0 0x0 0x0 0x0 0x0 0x0 0x0 0x0 0x0 0x0 0x0 0x0 0x0 0x0 0x0 0x0 0x0 0x0 0x0 0x0 0x0 0x0 0x0 0x0 0x0 0x0 0x0 0x0 0x0 0x0 0x0 0x0 0x0 0x0 0x0 0x0 0x0 0x0 0x0 0x0 0x0 0x0 0x0 0x0 0x0 0x0 0x0 0x0 0x0 0x0 0x0 0x0 0x0 0x0 0x0 0x0 0x0 0x0 0x0 0x0 0x0 0x0 0x0 0x0 0x0 0x0 0x0 0x0 0x0 0x0 0x0 0x0 0x0 0x0 0x0 0x0 0x0 0x0 0x0 0x0 0x0 0x0 0x0 0x0 0x0 0x0 0x0 0x0 0x0 0x0 0x0 0x0 0x0 0x0 0x0 0x0 0x0 0x0 0x0 0x0 0x0 0x0 0x0 0x0 0x0 0x0 0x0 0x0 0x0 0x0 0x0 0x0 0x0 0x0 0x0 0x0 0x0 0x0 0x0 0x0 0x0 0x0 0x0 0x0 0x0 0x0 0x0 0x0 0x0 0x0 0x0 0x0 0x0 0x0 0x0 0x0 0x0 0x0 0x0 0x0 0x0 0x0 0x0 0x0 0x0 0x0 0x0 0x0 0x0 0x0 0x0 0x0 0x0 0x0 0x0 0x0 0x0 0x0 0x0 0x0 0x0 0x0 0x0 0x0 0x0 0x0 0x0 0x0 0x0 0x0 0x0 0x0 0x0 0x0 0x0 0x0 0x0 0x0 0x0 0x0 0x0 0x0 0x0 0x0 0x0 0x0 0x0 0x0 0x0 0x0 0x0 0x0 0x0 0x0 0x0 0x0 0x0 0x0 0x0 0x0 0x0 0x0 0x0 0x0 0x0 0x0 0x0 0x0 0x0 0x0 0x0 0x0 0x0 0x0 0x0 0x0 0x0 0x0 0x0 0x0 0x0 0x0 0x0 0x0 0x0 0x0 0x0 0x0 0x0 0x0 0x0 0x0 0x0 0x0 0x0 0x0 0x0 0x0 0x0 0x0 0x0 0x0 0x0 0x0 0x0 0x0 0x0 0x0 0x0 0x0 0x0 0x0 0x0 0x0 0x0 0x0 0x0 0x0 0x0 0x0 0x0 0x0 0x0 0x0 0x0 0x0 0x0 0x0 0x0 0x0 0x0 0x0 0x0 0x0 0x0 0x0 0x0 0x0 0x0 0x0 0x0 0x0 0x0 0x0 0x0 0x0 0x0 0x0 0x0 0x0 0x0 0x0 0x0 0x0 0x0 0x0 0x0 0x0 0x0 0x0 0x0 0x0 0x0 0x0 0x0 0x0 0x0 0x0 0x0 0x0 0x0 0x0 0x0 0x0 0x0 0x0 0x0 0x0 0x0 0x0 0x0 0x0 0x0 0x0 0x0 0x0 0x0 0x0 0x0 0x0 0x0 0x0 0x0 0x0 0x0 0x0 0x0 0x0 0x0 0x0 0x0 0x0 0x0 0x0 0x0 0x0 0x0 0x0 0x0 0x0 0x0 0x0 0x0 0x0 0x0 0x0 0x0 0x0 0x0 0x0 0x0 0x0 0x0 0x0 0x0 0x0 0x0 0x0 0x0 0x0 0x0 0x0 0x0 0x0 0x0 0x0 0x0 0x0 0x0 0x0 0x0 0x0 0x0 0x0 0x0 0x0 0x0 0x0 0x0 0x0 0x0 0x0 0x0 0x0 0x0 0x0 0x0 0x0 0x0 0x0 0x0 0x0 0x0 0x0 0x0 0x0 0x0 0x0 0x0 0x0 0x0 0x0 0x0 0x0 0x0 0x0 0x0 0x0 0x0 0x0 0x0 0x0 0x0 0x0 0x0 0x0 0x0 0x0 0x0 0x0 0x0 0x0 0x0 0x0 0x0 0x0 0x0 0x0 0x0 0x0 0x0 0x0 0x0 0x0 0x0 0x0 0x0 0x0 0x0 0x0 0x0 0x0 0x0 0x0 0x0 0x0 0x0 0x0 0x0 0x0 0x0 0x0 0x0 0x0 0x0 0x0 0x0 0x0 0x0 0x0 0x0 0x0 0x0 0x0 0x0 0x0 0x0 0x0 0x0 0x0 0x0 0x0 0x0 0x0 0x0 0x0 0x0 0x0 0x0 0x0 0x0 0x0 0x0 0x0 0x0 0x0 0x0 0x0 0x0 0x0 0x0 0x0 0x0 0x0 0x0 0x0 0x0 0x0 0x0 0x0 0x0 0x0 0x0 0x0 0x0 0x0 0x0 0x0 0x0 0x0 0x0 0x0 0x0 0x0 0x0 0x0 0x0 0x0 0x0 0x0 0x0 0x0 0x0 0x0 0x0 0x0 0x0 0x0 0x0 0x0 0x0 0x0 0x0 0x0 0x0 0x0 0x0 0x0 0x0 0x0 0x0 0x0 0x0 0x0 0x0 0x0 0x0 0x0 0x0 0x0 0x0 0x0 0x0 0x0 0x0 0x0 0x0 0x0 0x0 0x0 0x0 0x0 0x0 0x0 0x0 0x0 0x0 0x0 0x0 0x0 0x0 0x0 0x0 0x0 0x0 0x0 0x0 0x0 0x0 0x0 0x0 0x0 0x0 0x0 0x0 0x0 0x0 0x0 0x0 0x0 0x0 0x0 0x0 0x0 0x0 0x0 0x0 0x0 0x0 0x0 0x0 0x0 0x0 0x0 0x0 0x0 0x0 0x0 0x0 0x0 0x0 0x0 0x0 0x0 0x0 0x0>;
					PS_Config_Lmt_FW_CC_P = <0x13a 0x13a 0x13a 0x13a 0x13a 0x13a 0x13a 0x13a 0x13a 0x13a 0x13a 0x13a 0x13a 0x13a 0x13a 0x13a 0x13a 0x13a 0x13a 0x13a 0x13a 0x13a 0x13a 0x13a 0x13a 0x13a 0x13a 0x13a 0x13a 0x13a 0x13a 0x13a 0x13a 0x13a 0x13a 0x13a 0x13a 0x13a 0x13a 0x13a 0x13a 0x13a 0x13a 0x13a 0x13a 0x13a 0x13a 0x13a 0x13a 0x13a 0x13a 0x13a 0x13a 0x13a 0x13a 0x13a 0x13a 0x13a 0x13a 0x13a 0x13a 0x13a 0x13a 0x13a 0x13a 0x13a 0x13a 0x13a 0x13a 0x13a 0x13a 0x13a 0x13a 0x13a 0x13a 0x13a 0x13a 0x13a 0x13a 0x13a 0x13a 0x13a 0x13a 0x13a 0x13a 0x13a 0x13a 0x13a 0x13a 0x13a 0x13a 0x13a 0x13a 0x13a 0x13a 0x13a 0x13a 0x13a 0x13a 0x13a 0x13a 0x13a 0x13a 0x13a 0x13a 0x13a 0x13a 0x13a 0x13a 0x13a 0x13a 0x13a 0x13a 0x13a 0x13a 0x13a 0x13a 0x13a 0x13a 0x13a 0x13a 0x13a 0x13a 0x13a 0x13a 0x13a 0x13a 0x13a 0x13a 0x13a 0x13a 0x13a 0x13a 0x13a 0x13a 0x13a 0x13a 0x13a 0x13a 0x13a 0x13a 0x13a 0x13a 0x13a 0x13a 0x13a 0x13a 0x13a 0x13a 0x13a 0x13a 0x13a 0x13a 0x13a 0x13a 0x13a 0x13a 0x13a 0x13a 0x13a 0x13a 0x13a 0x13a 0x13a 0x13a 0x13a 0x13a 0x13a 0x13a 0x13a 0x13a 0x13a 0x13a 0x13a 0x13a 0x13a 0x13a 0x13a 0x13a 0x13a 0x13a 0x13a 0x13a 0x13a 0x13a 0x13a 0x13a 0x13a 0x13a 0x13a 0x13a 0x13a 0x13a 0x13a 0x13a 0x13a 0x13a 0x13a 0x13a 0x13a 0x13a 0x13a 0x13a 0x13a 0x13a 0x13a 0x13a 0x13a 0x13a 0x13a 0x13a 0x13a 0x13a 0x13a 0x13a 0x13a 0x13a 0x13a 0x13a 0x13a 0x13a 0x13a 0x13a 0x13a 0x13a 0x13a 0x13a 0x13a 0x13a 0x13a 0x13a 0x13a 0x13a 0x13a 0x13a 0x13a 0x13a 0x13a 0x13a 0x13a 0x13a 0x13a 0x13a 0x13a 0x13a 0x13a 0x13a 0x13a 0x13a 0x13a 0x13a 0x13a 0x13a 0x13a 0x13a 0x13a 0x13a 0x13a 0x13a 0x13a 0x13a 0x13a 0x13a 0x13a 0x13a 0x13a 0x13a 0x13a 0x13a 0x13a 0x13a 0x13a 0x13a 0x13a 0x13a 0x13a 0x13a 0x13a 0x13a 0x13a 0x13a 0x13a 0x13a 0x13a 0x13a 0x13a 0x13a 0x13a 0x13a 0x13a 0x13a 0x13a 0x13a 0x13a 0x13a 0x13a 0x13a 0x13a 0x13a 0x13a 0x13a 0x13a 0x13a 0x13a 0x13a 0x13a 0x13a 0x13a 0x13a 0x13a 0x13a 0x13a 0x13a 0x13a 0x13a 0x13a 0x13a 0x13a 0x13a 0x13a 0x13a 0x13a 0x13a 0x13a 0x13a 0x13a 0x13a 0x13a 0x13a 0x13a 0x13a 0x13a 0x13a 0x13a 0x13a 0x13a 0x13a 0x13a 0x13a 0x13a 0x13a 0x13a 0x13a 0x13a 0x13a 0x13a 0x13a 0x13a 0x13a 0x13a 0x13a 0x13a 0x13a 0x13a 0x13a 0x13a 0x13a 0x13a 0x13a 0x13a 0x13a 0x13a 0x13a 0x13a 0x13a 0x13a 0x13a 0x13a 0x13a 0x13a 0x13a 0x13a 0x13a 0x13a 0x13a 0x13a 0x13a 0x13a 0x13a 0x13a 0x13a 0x13a 0x13a 0x13a 0x13a 0x13a 0x13a 0x13a 0x13a 0x13a 0x13a 0x13a 0x13a 0x13a 0x13a 0x13a 0x13a 0x13a 0x13a 0x13a 0x13a 0x13a 0x13a 0x13a 0x13a 0x13a 0x13a 0x13a 0x13a 0x13a 0x13a 0x13a 0x13a 0x13a 0x13a 0x13a 0x13a 0x13a 0x13a 0x13a 0x13a 0x13a 0x13a 0x13a 0x13a 0x13a 0x13a 0x13a 0x13a 0x13a 0x13a 0x13a 0x13a 0x13a 0x13a 0x13a 0x13a 0x13a 0x13a 0x13a 0x13a 0x13a 0x13a 0x13a 0x13a 0x13a 0x13a 0x13a 0x13a 0x13a 0x13a 0x13a 0x13a 0x13a 0x13a 0x13a 0x13a 0x13a 0x13a 0x13a 0x13a 0x13a 0x13a 0x13a 0x13a 0x13a 0x13a 0x13a 0x13a 0x13a 0x13a 0x13a 0x13a 0x13a 0x13a 0x13a 0x13a 0x13a 0x13a 0x13a 0x13a 0x13a 0x13a 0x13a 0x13a 0x13a 0x13a 0x13a 0x13a 0x13a 0x13a 0x13a 0x13a 0x13a 0x13a 0x13a 0x13a 0x13a 0x13a 0x13a 0x13a 0x13a 0x13a 0x13a 0x13a 0x13a 0x13a 0x13a 0x13a 0x13a 0x13a 0x13a 0x13a 0x13a 0x13a 0x13a 0x13a 0x13a 0x13a 0x13a 0x13a 0x13a 0x13a 0x13a 0x13a 0x13a 0x13a 0x13a 0x13a 0x13a 0x13a 0x13a 0x13a 0x13a 0x13a 0x13a 0x13a 0x13a 0x13a 0x13a 0x13a 0x13a 0x13a 0x13a 0x13a 0x13a 0x13a 0x13a 0x13a 0x13a 0x13a 0x13a 0x13a 0x13a 0x13a 0x13a 0x13a 0x13a 0x13a 0x13a 0x13a 0x13a 0x13a 0x13a 0x13a 0x13a 0x13a 0x13a 0x13a 0x13a 0x13a 0x13a 0x13a 0x13a 0x13a 0x13a 0x13a 0x13a 0x13a 0x13a 0x13a 0x13a 0x13a 0x13a 0x13a 0x13a 0x13a 0x13a 0x13a 0x13a 0x13a 0x13a 0x13a 0x13a 0x13a 0x13a 0x13a 0x13a 0x13a 0x13a 0x13a 0x13a 0x13a 0x13a 0x13a 0x13a 0x13a 0x13a 0x13a 0x13a 0x13a 0x13a 0x13a 0x13a 0x13a 0x13a 0x13a 0x13a 0x13a 0x13a 0x13a 0x13a 0x13a 0x13a 0x13a 0x13a 0x13a 0x13a 0x13a 0x13a 0x13a 0x13a 0x13a 0x13a 0x13a 0x13a 0x13a 0x13a 0x13a 0x13a 0x13a 0x13a 0x13a 0x13a 0x13a 0x13a 0x13a 0x13a 0x13a 0x13a 0x13a>;
					PS_Config_Lmt_FW_Diff_N = <0xffffffb5 0xffffffb5 0xffffffb5 0xffffffb5 0xffffffb5 0xffffffb5 0xffffffb5 0xffffffb5 0xffffffb5 0xffffffb5 0xffffffb5 0xffffffb5 0xffffffb5 0xffffffb5 0xffffffb5 0xffffffb5 0xffffffb5 0xffffffb5 0xffffffb5 0xffffffb5 0xffffffb5 0xffffffb5 0xffffffb5 0xffffffb5 0xffffffb5 0xffffffb5 0xffffffb5 0xffffffb5 0xffffffb5 0xffffffb5 0xffffffb5 0xffffffb5 0xffffffb5 0xffffffb5 0xffffffb5 0xffffffb5 0xffffffb5 0xffffffb5 0xffffffb5 0xffffffb5 0xffffffb5 0xffffffb5 0xffffffb5 0xffffffb5 0xffffffb5 0xffffffb5 0xffffffb5 0xffffffb5 0xffffffb5 0xffffffb5 0xffffffb5 0xffffffb5 0xffffffb5 0xffffffb5 0xffffffb5 0xffffffb5 0xffffffb5 0xffffffb5 0xffffffb5 0xffffffb5 0xffffffb5 0xffffffb5 0xffffffb5 0xffffffb5 0xffffffb5 0xffffffb5 0xffffffb5 0xffffffb5 0xffffffb5 0xffffffb5 0xffffffb5 0xffffffb5 0xffffffb5 0xffffffb5 0xffffffb5 0xffffffb5 0xffffffb5 0xffffffb5 0xffffffb5 0xffffffb5 0xffffffb5 0xffffffb5 0xffffffb5 0xffffffb5 0xffffffb5 0xffffffb5 0xffffffb5 0xffffffb5 0xffffffb5 0xffffffb5 0xffffffb5 0xffffffb5 0xffffffb5 0xffffffb5 0xffffffb5 0xffffffb5 0xffffffb5 0xffffffb5 0xffffffb5 0xffffffb5 0xffffffb5 0xffffffb5 0xffffffb5 0xffffffb5 0xffffffb5 0xffffffb5 0xffffffb5 0xffffffb5 0xffffffb5 0xffffffb5 0xffffffb5 0xffffffb5 0xffffffb5 0xffffffb5 0xffffffb5 0xffffffb5 0xffffffb5 0xffffffb5 0xffffffb5 0xffffffb5 0xffffffb5 0xffffffb5 0xffffffb5 0xffffffb5 0xffffffb5 0xffffffb5 0xffffffb5 0xffffffb5 0xffffffb5 0xffffffb5 0xffffffb5 0xffffffb5 0xffffffb5 0xffffffb5 0xffffffb5 0xffffffb5 0xffffffb5 0xffffffb5 0xffffffb5 0xffffffb5 0xffffffb5 0xffffffb5 0xffffffb5 0xffffffb5 0xffffffb5 0xffffffb5 0xffffffb5 0xffffffb5 0xffffffb5 0xffffffb5 0xffffffb5 0xffffffb5 0xffffffb5 0xffffffb5 0xffffffb5 0xffffffb5 0xffffffb5 0xffffffb5 0xffffffb5 0xffffffb5 0xffffffb5 0xffffffb5 0xffffffb5 0xffffffb5 0xffffffb5 0xffffffb5 0xffffffb5 0xffffffb5 0xffffffb5 0xffffffb5 0xffffffb5 0xffffffb5 0xffffffb5 0xffffffb5 0xffffffb5 0xffffffb5 0xffffffb5 0xffffffb5 0xffffffb5 0xffffffb5 0xffffffb5 0xffffffb5 0xffffffb5 0xffffffb5 0xffffffb5 0xffffffb5 0xffffffb5 0xffffffb5 0xffffffb5 0xffffffb5 0xffffffb5 0xffffffb5 0xffffffb5 0xffffffb5 0xffffffb5 0xffffffb5 0xffffffb5 0xffffffb5 0xffffffb5 0xffffffb5 0xffffffb5 0xffffffb5 0xffffffb5 0xffffffb5 0xffffffb5 0xffffffb5 0xffffffb5 0xffffffb5 0xffffffb5 0xffffffb5 0xffffffb5 0xffffffb5 0xffffffb5 0xffffffb5 0xffffffb5 0xffffffb5 0xffffffb5 0xffffffb5 0xffffffb5 0xffffffb5 0xffffffb5 0xffffffb5 0xffffffb5 0xffffffb5 0xffffffb5 0xffffffb5 0xffffffb5 0xffffffb5 0xffffffb5 0xffffffb5 0xffffffb5 0xffffffb5 0xffffffb5 0xffffffb5 0xffffffb5 0xffffffb5 0xffffffb5 0xffffffb5 0xffffffb5 0xffffffb5 0xffffffb5 0xffffffb5 0xffffffb5 0xffffffb5 0xffffffb5 0xffffffb5 0xffffffb5 0xffffffb5 0xffffffb5 0xffffffb5 0xffffffb5 0xffffffb5 0xffffffb5 0xffffffb5 0xffffffb5 0xffffffb5 0xffffffb5 0xffffffb5 0xffffffb5 0xffffffb5 0xffffffb5 0xffffffb5 0xffffffb5 0xffffffb5 0xffffffb5 0xffffffb5 0xffffffb5 0xffffffb5 0xffffffb5 0xffffffb5 0xffffffb5 0xffffffb5 0xffffffb5 0xffffffb5 0xffffffb5 0xffffffb5 0xffffffb5 0xffffffb5 0xffffffb5 0xffffffb5 0xffffffb5 0xffffffb5 0xffffffb5 0xffffffb5 0xffffffb5 0xffffffb5 0xffffffb5 0xffffffb5 0xffffffb5 0xffffffb5 0xffffffb5 0xffffffb5 0xffffffb5 0xffffffb5 0xffffffb5 0xffffffb5 0xffffffb5 0xffffffb5 0xffffffb5 0xffffffb5 0xffffffb5 0xffffffb5 0xffffffb5 0xffffffb5 0xffffffb5 0xffffffb5 0xffffffb5 0xffffffb5 0xffffffb5 0xffffffb5 0xffffffb5 0xffffffb5 0xffffffb5 0xffffffb5 0xffffffb5 0xffffffb5 0xffffffb5 0xffffffb5 0xffffffb5 0xffffffb5 0xffffffb5 0xffffffb5 0xffffffb5 0xffffffb5 0xffffffb5 0xffffffb5 0xffffffb5 0xffffffb5 0xffffffb5 0xffffffb5 0xffffffb5 0xffffffb5 0xffffffb5 0xffffffb5 0xffffffb5 0xffffffb5 0xffffffb5 0xffffffb5 0xffffffb5 0xffffffb5 0xffffffb5 0xffffffb5 0xffffffb5 0xffffffb5 0xffffffb5 0xffffffb5 0xffffffb5 0xffffffb5 0xffffffb5 0xffffffb5 0xffffffb5 0xffffffb5 0xffffffb5 0xffffffb5 0xffffffb5 0xffffffb5 0xffffffb5 0xffffffb5 0xffffffb5 0xffffffb5 0xffffffb5 0xffffffb5 0xffffffb5 0xffffffb5 0xffffffb5 0xffffffb5 0xffffffb5 0xffffffb5 0xffffffb5 0xffffffb5 0xffffffb5 0xffffffb5 0xffffffb5 0xffffffb5 0xffffffb5 0xffffffb5 0xffffffb5 0xffffffb5 0xffffffb5 0xffffffb5 0xffffffb5 0xffffffb5 0xffffffb5 0xffffffb5 0xffffffb5 0xffffffb5 0xffffffb5 0xffffffb5 0xffffffb5 0xffffffb5 0xffffffb5 0xffffffb5 0xffffffb5 0xffffffb5 0xffffffb5 0xffffffb5 0xffffffb5 0xffffffb5 0xffffffb5 0xffffffb5 0xffffffb5 0xffffffb5 0xffffffb5 0xffffffb5 0xffffffb5 0xffffffb5 0xffffffb5 0xffffffb5 0xffffffb5 0xffffffb5 0xffffffb5 0xffffffb5 0xffffffb5 0xffffffb5 0xffffffb5 0xffffffb5 0xffffffb5 0xffffffb5 0xffffffb5 0xffffffb5 0xffffffb5 0xffffffb5 0xffffffb5 0xffffffb5 0xffffffb5 0xffffffb5 0xffffffb5 0xffffffb5 0xffffffb5 0xffffffb5 0xffffffb5 0xffffffb5 0xffffffb5 0xffffffb5 0xffffffb5 0xffffffb5 0xffffffb5 0xffffffb5 0xffffffb5 0xffffffb5 0xffffffb5 0xffffffb5 0xffffffb5 0xffffffb5 0xffffffb5 0xffffffb5 0xffffffb5 0xffffffb5 0xffffffb5 0xffffffb5 0xffffffb5 0xffffffb5 0xffffffb5 0xffffffb5 0xffffffb5 0xffffffb5 0xffffffb5 0xffffffb5 0xffffffb5 0xffffffb5 0xffffffb5 0xffffffb5 0xffffffb5 0xffffffb5 0xffffffb5 0xffffffb5 0xffffffb5 0xffffffb5 0xffffffb5 0xffffffb5 0xffffffb5 0xffffffb5 0xffffffb5 0xffffffb5 0xffffffb5 0xffffffb5 0xffffffb5 0xffffffb5 0xffffffb5 0xffffffb5 0xffffffb5 0xffffffb5 0xffffffb5 0xffffffb5 0xffffffb5 0xffffffb5 0xffffffb5 0xffffffb5 0xffffffb5 0xffffffb5 0xffffffb5 0xffffffb5 0xffffffb5 0xffffffb5 0xffffffb5 0xffffffb5 0xffffffb5 0xffffffb5 0xffffffb5 0xffffffb5 0xffffffb5 0xffffffb5 0xffffffb5 0xffffffb5 0xffffffb5 0xffffffb5 0xffffffb5 0xffffffb5 0xffffffb5 0xffffffb5 0xffffffb5 0xffffffb5 0xffffffb5 0xffffffb5 0xffffffb5 0xffffffb5 0xffffffb5 0xffffffb5 0xffffffb5 0xffffffb5 0xffffffb5 0xffffffb5 0xffffffb5 0xffffffb5 0xffffffb5 0xffffffb5 0xffffffb5 0xffffffb5 0xffffffb5 0xffffffb5 0xffffffb5 0xffffffb5 0xffffffb5 0xffffffb5 0xffffffb5 0xffffffb5 0xffffffb5 0xffffffb5 0xffffffb5 0xffffffb5 0xffffffb5 0xffffffb5 0xffffffb5 0xffffffb5 0xffffffb5 0xffffffb5 0xffffffb5 0xffffffb5 0xffffffb5 0xffffffb5 0xffffffb5 0xffffffb5 0xffffffb5 0xffffffb5 0xffffffb5 0xffffffb5 0xffffffb5 0xffffffb5 0xffffffb5 0xffffffb5 0xffffffb5 0xffffffb5 0xffffffb5 0xffffffb5 0xffffffb5 0xffffffb5 0xffffffb5 0xffffffb5 0xffffffb5 0xffffffb5 0xffffffb5 0xffffffb5 0xffffffb5 0xffffffb5 0xffffffb5 0xffffffb5 0xffffffb5 0xffffffb5 0xffffffb5 0xffffffb5 0xffffffb5 0xffffffb5 0xffffffb5 0xffffffb5 0xffffffb5 0xffffffb5 0xffffffb5 0xffffffb5 0xffffffb5 0xffffffb5 0xffffffb5 0xffffffb5 0xffffffb5 0xffffffb5 0xffffffb5 0xffffffb5 0xffffffb5 0xffffffb5 0xffffffb5 0xffffffb5 0xffffffb5 0xffffffb5 0xffffffb5 0xffffffb5 0xffffffb5 0xffffffb5 0xffffffb5 0xffffffb5 0xffffffb5 0xffffffb5 0xffffffb5 0xffffffb5 0xffffffb5 0xffffffb5 0xffffffb5 0xffffffb5 0xffffffb5 0xffffffb5 0xffffffb5 0xffffffb5 0xffffffb5 0xffffffb5 0xffffffb5 0xffffffb5 0xffffffb5 0xffffffb5 0xffffffb5 0xffffffb5 0xffffffb5 0xffffffb5 0xffffffb5 0xffffffb5 0xffffffb5 0xffffffb5 0xffffffb5 0xffffffb5 0xffffffb5 0xffffffb5 0xffffffb5 0xffffffb5 0xffffffb5 0xffffffb5 0xffffffb5 0xffffffb5 0xffffffb5 0xffffffb5 0xffffffb5 0xffffffb5 0xffffffb5 0xffffffb5 0xffffffb5>;
					PS_Config_Lmt_FW_Diff_P = <0x4b 0x4b 0x4b 0x4b 0x4b 0x4b 0x4b 0x4b 0x4b 0x4b 0x4b 0x4b 0x4b 0x4b 0x4b 0x4b 0x4b 0x4b 0x4b 0x4b 0x4b 0x4b 0x4b 0x4b 0x4b 0x4b 0x4b 0x4b 0x4b 0x4b 0x4b 0x4b 0x4b 0x4b 0x4b 0x4b 0x4b 0x4b 0x4b 0x4b 0x4b 0x4b 0x4b 0x4b 0x4b 0x4b 0x4b 0x4b 0x4b 0x4b 0x4b 0x4b 0x4b 0x4b 0x4b 0x4b 0x4b 0x4b 0x4b 0x4b 0x4b 0x4b 0x4b 0x4b 0x4b 0x4b 0x4b 0x4b 0x4b 0x4b 0x4b 0x4b 0x4b 0x4b 0x4b 0x4b 0x4b 0x4b 0x4b 0x4b 0x4b 0x4b 0x4b 0x4b 0x4b 0x4b 0x4b 0x4b 0x4b 0x4b 0x4b 0x4b 0x4b 0x4b 0x4b 0x4b 0x4b 0x4b 0x4b 0x4b 0x4b 0x4b 0x4b 0x4b 0x4b 0x4b 0x4b 0x4b 0x4b 0x4b 0x4b 0x4b 0x4b 0x4b 0x4b 0x4b 0x4b 0x4b 0x4b 0x4b 0x4b 0x4b 0x4b 0x4b 0x4b 0x4b 0x4b 0x4b 0x4b 0x4b 0x4b 0x4b 0x4b 0x4b 0x4b 0x4b 0x4b 0x4b 0x4b 0x4b 0x4b 0x4b 0x4b 0x4b 0x4b 0x4b 0x4b 0x4b 0x4b 0x4b 0x4b 0x4b 0x4b 0x4b 0x4b 0x4b 0x4b 0x4b 0x4b 0x4b 0x4b 0x4b 0x4b 0x4b 0x4b 0x4b 0x4b 0x4b 0x4b 0x4b 0x4b 0x4b 0x4b 0x4b 0x4b 0x4b 0x4b 0x4b 0x4b 0x4b 0x4b 0x4b 0x4b 0x4b 0x4b 0x4b 0x4b 0x4b 0x4b 0x4b 0x4b 0x4b 0x4b 0x4b 0x4b 0x4b 0x4b 0x4b 0x4b 0x4b 0x4b 0x4b 0x4b 0x4b 0x4b 0x4b 0x4b 0x4b 0x4b 0x4b 0x4b 0x4b 0x4b 0x4b 0x4b 0x4b 0x4b 0x4b 0x4b 0x4b 0x4b 0x4b 0x4b 0x4b 0x4b 0x4b 0x4b 0x4b 0x4b 0x4b 0x4b 0x4b 0x4b 0x4b 0x4b 0x4b 0x4b 0x4b 0x4b 0x4b 0x4b 0x4b 0x4b 0x4b 0x4b 0x4b 0x4b 0x4b 0x4b 0x4b 0x4b 0x4b 0x4b 0x4b 0x4b 0x4b 0x4b 0x4b 0x4b 0x4b 0x4b 0x4b 0x4b 0x4b 0x4b 0x4b 0x4b 0x4b 0x4b 0x4b 0x4b 0x4b 0x4b 0x4b 0x4b 0x4b 0x4b 0x4b 0x4b 0x4b 0x4b 0x4b 0x4b 0x4b 0x4b 0x4b 0x4b 0x4b 0x4b 0x4b 0x4b 0x4b 0x4b 0x4b 0x4b 0x4b 0x4b 0x4b 0x4b 0x4b 0x4b 0x4b 0x4b 0x4b 0x4b 0x4b 0x4b 0x4b 0x4b 0x4b 0x4b 0x4b 0x4b 0x4b 0x4b 0x4b 0x4b 0x4b 0x4b 0x4b 0x4b 0x4b 0x4b 0x4b 0x4b 0x4b 0x4b 0x4b 0x4b 0x4b 0x4b 0x4b 0x4b 0x4b 0x4b 0x4b 0x4b 0x4b 0x4b 0x4b 0x4b 0x4b 0x4b 0x4b 0x4b 0x4b 0x4b 0x4b 0x4b 0x4b 0x4b 0x4b 0x4b 0x4b 0x4b 0x4b 0x4b 0x4b 0x4b 0x4b 0x4b 0x4b 0x4b 0x4b 0x4b 0x4b 0x4b 0x4b 0x4b 0x4b 0x4b 0x4b 0x4b 0x4b 0x4b 0x4b 0x4b 0x4b 0x4b 0x4b 0x4b 0x4b 0x4b 0x4b 0x4b 0x4b 0x4b 0x4b 0x4b 0x4b 0x4b 0x4b 0x4b 0x4b 0x4b 0x4b 0x4b 0x4b 0x4b 0x4b 0x4b 0x4b 0x4b 0x4b 0x4b 0x4b 0x4b 0x4b 0x4b 0x4b 0x4b 0x4b 0x4b 0x4b 0x4b 0x4b 0x4b 0x4b 0x4b 0x4b 0x4b 0x4b 0x4b 0x4b 0x4b 0x4b 0x4b 0x4b 0x4b 0x4b 0x4b 0x4b 0x4b 0x4b 0x4b 0x4b 0x4b 0x4b 0x4b 0x4b 0x4b 0x4b 0x4b 0x4b 0x4b 0x4b 0x4b 0x4b 0x4b 0x4b 0x4b 0x4b 0x4b 0x4b 0x4b 0x4b 0x4b 0x4b 0x4b 0x4b 0x4b 0x4b 0x4b 0x4b 0x4b 0x4b 0x4b 0x4b 0x4b 0x4b 0x4b 0x4b 0x4b 0x4b 0x4b 0x4b 0x4b 0x4b 0x4b 0x4b 0x4b 0x4b 0x4b 0x4b 0x4b 0x4b 0x4b 0x4b 0x4b 0x4b 0x4b 0x4b 0x4b 0x4b 0x4b 0x4b 0x4b 0x4b 0x4b 0x4b 0x4b 0x4b 0x4b 0x4b 0x4b 0x4b 0x4b 0x4b 0x4b 0x4b 0x4b 0x4b 0x4b 0x4b 0x4b 0x4b 0x4b 0x4b 0x4b 0x4b 0x4b 0x4b 0x4b 0x4b 0x4b 0x4b 0x4b 0x4b 0x4b 0x4b 0x4b 0x4b 0x4b 0x4b 0x4b 0x4b 0x4b 0x4b 0x4b 0x4b 0x4b 0x4b 0x4b 0x4b 0x4b 0x4b 0x4b 0x4b 0x4b 0x4b 0x4b 0x4b 0x4b 0x4b 0x4b 0x4b 0x4b 0x4b 0x4b 0x4b 0x4b 0x4b 0x4b 0x4b 0x4b 0x4b 0x4b 0x4b 0x4b 0x4b 0x4b 0x4b 0x4b 0x4b 0x4b 0x4b 0x4b 0x4b 0x4b 0x4b 0x4b 0x4b 0x4b 0x4b 0x4b 0x4b 0x4b 0x4b 0x4b 0x4b 0x4b 0x4b 0x4b 0x4b 0x4b 0x4b 0x4b 0x4b 0x4b 0x4b 0x4b 0x4b 0x4b 0x4b 0x4b 0x4b 0x4b 0x4b 0x4b 0x4b 0x4b 0x4b 0x4b 0x4b 0x4b 0x4b 0x4b 0x4b 0x4b 0x4b 0x4b 0x4b 0x4b 0x4b 0x4b 0x4b 0x4b 0x4b 0x4b 0x4b 0x4b 0x4b 0x4b 0x4b 0x4b 0x4b 0x4b 0x4b 0x4b 0x4b 0x4b 0x4b 0x4b 0x4b 0x4b 0x4b 0x4b 0x4b 0x4b 0x4b 0x4b>;
					PS_Config_Lmt_FW_Rawdata_N = <0xf0 0xf0 0xf0 0xf0 0xf0 0xf0 0xf0 0xf0 0xf0 0xf0 0xf0 0xf0 0xf0 0xf0 0xf0 0xf0 0xf0 0xf0 0xf0 0xf0 0xf0 0xf0 0xf0 0xf0 0xf0 0xf0 0xf0 0xf0 0xf0 0xf0 0xf0 0xf0 0xf0 0xf0 0xf0 0xf0 0xf0 0xf0 0xf0 0xf0 0xf0 0xf0 0xf0 0xf0 0xf0 0xf0 0xf0 0xf0 0xf0 0xf0 0xf0 0xf0 0xf0 0xf0 0xf0 0xf0 0xf0 0xf0 0xf0 0xf0 0xf0 0xf0 0xf0 0xf0 0xf0 0xf0 0xf0 0xf0 0xf0 0xf0 0xf0 0xf0 0xf0 0xf0 0xf0 0xf0 0xf0 0xf0 0xf0 0xf0 0xf0 0xf0 0xf0 0xf0 0xf0 0xf0 0xf0 0xf0 0xf0 0xf0 0xf0 0xf0 0xf0 0xf0 0xf0 0xf0 0xf0 0xf0 0xf0 0xf0 0xf0 0xf0 0xf0 0xf0 0xf0 0xf0 0xf0 0xf0 0xf0 0xf0 0xf0 0xf0 0xf0 0xf0 0xf0 0xf0 0xf0 0xf0 0xf0 0xf0 0xf0 0xf0 0xf0 0xf0 0xf0 0xf0 0xf0 0xf0 0xf0 0xf0 0xf0 0xf0 0xf0 0xf0 0xf0 0xf0 0xf0 0xf0 0xf0 0xf0 0xf0 0xf0 0xf0 0xf0 0xf0 0xf0 0xf0 0xf0 0xf0 0xf0 0xf0 0xf0 0xf0 0xf0 0xf0 0xf0 0xf0 0xf0 0xf0 0xf0 0xf0 0xf0 0xf0 0xf0 0xf0 0xf0 0xf0 0xf0 0xf0 0xf0 0xf0 0xf0 0xf0 0xf0 0xf0 0xf0 0xf0 0xf0 0xf0 0xf0 0xf0 0xf0 0xf0 0xf0 0xf0 0xf0 0xf0 0xf0 0xf0 0xf0 0xf0 0xf0 0xf0 0xf0 0xf0 0xf0 0xf0 0xf0 0xf0 0xf0 0xf0 0xf0 0xf0 0xf0 0xf0 0xf0 0xf0 0xf0 0xf0 0xf0 0xf0 0xf0 0xf0 0xf0 0xf0 0xf0 0xf0 0xf0 0xf0 0xf0 0xf0 0xf0 0xf0 0xf0 0xf0 0xf0 0xf0 0xf0 0xf0 0xf0 0xf0 0xf0 0xf0 0xf0 0xf0 0xf0 0xf0 0xf0 0xf0 0xf0 0xf0 0xf0 0xf0 0xf0 0xf0 0xf0 0xf0 0xf0 0xf0 0xf0 0xf0 0xf0 0xf0 0xf0 0xf0 0xf0 0xf0 0xf0 0xf0 0xf0 0xf0 0xf0 0xf0 0xf0 0xf0 0xf0 0xf0 0xf0 0xf0 0xf0 0xf0 0xf0 0xf0 0xf0 0xf0 0xf0 0xf0 0xf0 0xf0 0xf0 0xf0 0xf0 0xf0 0xf0 0xf0 0xf0 0xf0 0xf0 0xf0 0xf0 0xf0 0xf0 0xf0 0xf0 0xf0 0xf0 0xf0 0xf0 0xf0 0xf0 0xf0 0xf0 0xf0 0xf0 0xf0 0xf0 0xf0 0xf0 0xf0 0xf0 0xf0 0xf0 0xf0 0xf0 0xf0 0xf0 0xf0 0xf0 0xf0 0xf0 0xf0 0xf0 0xf0 0xf0 0xf0 0xf0 0xf0 0xf0 0xf0 0xf0 0xf0 0xf0 0xf0 0xf0 0xf0 0xf0 0xf0 0xf0 0xf0 0xf0 0xf0 0xf0 0xf0 0xf0 0xf0 0xf0 0xf0 0xf0 0xf0 0xf0 0xf0 0xf0 0xf0 0xf0 0xf0 0xf0 0xf0 0xf0 0xf0 0xf0 0xf0 0xf0 0xf0 0xf0 0xf0 0xf0 0xf0 0xf0 0xf0 0xf0 0xf0 0xf0 0xf0 0xf0 0xf0 0xf0 0xf0 0xf0 0xf0 0xf0 0xf0 0xf0 0xf0 0xf0 0xf0 0xf0 0xf0 0xf0 0xf0 0xf0 0xf0 0xf0 0xf0 0xf0 0xf0 0xf0 0xf0 0xf0 0xf0 0xf0 0xf0 0xf0 0xf0 0xf0 0xf0 0xf0 0xf0 0xf0 0xf0 0xf0 0xf0 0xf0 0xf0 0xf0 0xf0 0xf0 0xf0 0xf0 0xf0 0xf0 0xf0 0xf0 0xf0 0xf0 0xf0 0xf0 0xf0 0xf0 0xf0 0xf0 0xf0 0xf0 0xf0 0xf0 0xf0 0xf0 0xf0 0xf0 0xf0 0xf0 0xf0 0xf0 0xf0 0xf0 0xf0 0xf0 0xf0 0xf0 0xf0 0xf0 0xf0 0xf0 0xf0 0xf0 0xf0 0xf0 0xf0 0xf0 0xf0 0xf0 0xf0 0xf0 0xf0 0xf0 0xf0 0xf0 0xf0 0xf0 0xf0 0xf0 0xf0 0xf0 0xf0 0xf0 0xf0 0xf0 0xf0 0xf0 0xf0 0xf0 0xf0 0xf0 0xf0 0xf0 0xf0 0xf0 0xf0 0xf0 0xf0 0xf0 0xf0 0xf0 0xf0 0xf0 0xf0 0xf0 0xf0 0xf0 0xf0 0xf0 0xf0 0xf0 0xf0 0xf0 0xf0 0xf0 0xf0 0xf0 0xf0 0xf0 0xf0 0xf0 0xf0 0xf0 0xf0 0xf0 0xf0 0xf0 0xf0 0xf0 0xf0 0xf0 0xf0 0xf0 0xf0 0xf0 0xf0 0xf0 0xf0 0xf0 0xf0 0xf0 0xf0 0xf0 0xf0 0xf0 0xf0 0xf0 0xf0 0xf0 0xf0 0xf0 0xf0 0xf0 0xf0 0xf0 0xf0 0xf0 0xf0 0xf0 0xf0 0xf0 0xf0 0xf0 0xf0 0xf0 0xf0 0xf0 0xf0 0xf0 0xf0 0xf0 0xf0 0xf0 0xf0 0xf0 0xf0 0xf0 0xf0 0xf0 0xf0 0xf0 0xf0 0xf0 0xf0 0xf0 0xf0 0xf0 0xf0 0xf0 0xf0 0xf0 0xf0 0xf0 0xf0 0xf0 0xf0 0xf0 0xf0 0xf0 0xf0 0xf0 0xf0 0xf0 0xf0 0xf0 0xf0 0xf0 0xf0 0xf0 0xf0 0xf0 0xf0 0xf0 0xf0 0xf0 0xf0 0xf0 0xf0 0xf0 0xf0 0xf0 0xf0 0xf0 0xf0 0xf0 0xf0 0xf0 0xf0 0xf0 0xf0 0xf0 0xf0 0xf0 0xf0 0xf0 0xf0 0xf0 0xf0 0xf0 0xf0 0xf0 0xf0 0xf0 0xf0 0xf0 0xf0 0xf0 0xf0 0xf0 0xf0 0xf0 0xf0 0xf0 0xf0 0xf0 0xf0 0xf0 0xf0 0xf0 0xf0>;
					PS_Config_Lmt_FW_Rawdata_P = <0xa00 0xa00 0xa00 0xa00 0xa00 0xa00 0xa00 0xa00 0xa00 0xa00 0xa00 0xa00 0xa00 0xa00 0xa00 0xa00 0xa00 0xa00 0xa00 0xa00 0xa00 0xa00 0xa00 0xa00 0xa00 0xa00 0xa00 0xa00 0xa00 0xa00 0xa00 0xa00 0xa00 0xa00 0xa00 0xa00 0xa00 0xa00 0xa00 0xa00 0xa00 0xa00 0xa00 0xa00 0xa00 0xa00 0xa00 0xa00 0xa00 0xa00 0xa00 0xa00 0xa00 0xa00 0xa00 0xa00 0xa00 0xa00 0xa00 0xa00 0xa00 0xa00 0xa00 0xa00 0xa00 0xa00 0xa00 0xa00 0xa00 0xa00 0xa00 0xa00 0xa00 0xa00 0xa00 0xa00 0xa00 0xa00 0xa00 0xa00 0xa00 0xa00 0xa00 0xa00 0xa00 0xa00 0xa00 0xa00 0xa00 0xa00 0xa00 0xa00 0xa00 0xa00 0xa00 0xa00 0xa00 0xa00 0xa00 0xa00 0xa00 0xa00 0xa00 0xa00 0xa00 0xa00 0xa00 0xa00 0xa00 0xa00 0xa00 0xa00 0xa00 0xa00 0xa00 0xa00 0xa00 0xa00 0xa00 0xa00 0xa00 0xa00 0xa00 0xa00 0xa00 0xa00 0xa00 0xa00 0xa00 0xa00 0xa00 0xa00 0xa00 0xa00 0xa00 0xa00 0xa00 0xa00 0xa00 0xa00 0xa00 0xa00 0xa00 0xa00 0xa00 0xa00 0xa00 0xa00 0xa00 0xa00 0xa00 0xa00 0xa00 0xa00 0xa00 0xa00 0xa00 0xa00 0xa00 0xa00 0xa00 0xa00 0xa00 0xa00 0xa00 0xa00 0xa00 0xa00 0xa00 0xa00 0xa00 0xa00 0xa00 0xa00 0xa00 0xa00 0xa00 0xa00 0xa00 0xa00 0xa00 0xa00 0xa00 0xa00 0xa00 0xa00 0xa00 0xa00 0xa00 0xa00 0xa00 0xa00 0xa00 0xa00 0xa00 0xa00 0xa00 0xa00 0xa00 0xa00 0xa00 0xa00 0xa00 0xa00 0xa00 0xa00 0xa00 0xa00 0xa00 0xa00 0xa00 0xa00 0xa00 0xa00 0xa00 0xa00 0xa00 0xa00 0xa00 0xa00 0xa00 0xa00 0xa00 0xa00 0xa00 0xa00 0xa00 0xa00 0xa00 0xa00 0xa00 0xa00 0xa00 0xa00 0xa00 0xa00 0xa00 0xa00 0xa00 0xa00 0xa00 0xa00 0xa00 0xa00 0xa00 0xa00 0xa00 0xa00 0xa00 0xa00 0xa00 0xa00 0xa00 0xa00 0xa00 0xa00 0xa00 0xa00 0xa00 0xa00 0xa00 0xa00 0xa00 0xa00 0xa00 0xa00 0xa00 0xa00 0xa00 0xa00 0xa00 0xa00 0xa00 0xa00 0xa00 0xa00 0xa00 0xa00 0xa00 0xa00 0xa00 0xa00 0xa00 0xa00 0xa00 0xa00 0xa00 0xa00 0xa00 0xa00 0xa00 0xa00 0xa00 0xa00 0xa00 0xa00 0xa00 0xa00 0xa00 0xa00 0xa00 0xa00 0xa00 0xa00 0xa00 0xa00 0xa00 0xa00 0xa00 0xa00 0xa00 0xa00 0xa00 0xa00 0xa00 0xa00 0xa00 0xa00 0xa00 0xa00 0xa00 0xa00 0xa00 0xa00 0xa00 0xa00 0xa00 0xa00 0xa00 0xa00 0xa00 0xa00 0xa00 0xa00 0xa00 0xa00 0xa00 0xa00 0xa00 0xa00 0xa00 0xa00 0xa00 0xa00 0xa00 0xa00 0xa00 0xa00 0xa00 0xa00 0xa00 0xa00 0xa00 0xa00 0xa00 0xa00 0xa00 0xa00 0xa00 0xa00 0xa00 0xa00 0xa00 0xa00 0xa00 0xa00 0xa00 0xa00 0xa00 0xa00 0xa00 0xa00 0xa00 0xa00 0xa00 0xa00 0xa00 0xa00 0xa00 0xa00 0xa00 0xa00 0xa00 0xa00 0xa00 0xa00 0xa00 0xa00 0xa00 0xa00 0xa00 0xa00 0xa00 0xa00 0xa00 0xa00 0xa00 0xa00 0xa00 0xa00 0xa00 0xa00 0xa00 0xa00 0xa00 0xa00 0xa00 0xa00 0xa00 0xa00 0xa00 0xa00 0xa00 0xa00 0xa00 0xa00 0xa00 0xa00 0xa00 0xa00 0xa00 0xa00 0xa00 0xa00 0xa00 0xa00 0xa00 0xa00 0xa00 0xa00 0xa00 0xa00 0xa00 0xa00 0xa00 0xa00 0xa00 0xa00 0xa00 0xa00 0xa00 0xa00 0xa00 0xa00 0xa00 0xa00 0xa00 0xa00 0xa00 0xa00 0xa00 0xa00 0xa00 0xa00 0xa00 0xa00 0xa00 0xa00 0xa00 0xa00 0xa00 0xa00 0xa00 0xa00 0xa00 0xa00 0xa00 0xa00 0xa00 0xa00 0xa00 0xa00 0xa00 0xa00 0xa00 0xa00 0xa00 0xa00 0xa00 0xa00 0xa00 0xa00 0xa00 0xa00 0xa00 0xa00 0xa00 0xa00 0xa00 0xa00 0xa00 0xa00 0xa00 0xa00 0xa00 0xa00 0xa00 0xa00 0xa00 0xa00 0xa00 0xa00 0xa00 0xa00 0xa00 0xa00 0xa00 0xa00 0xa00 0xa00 0xa00 0xa00 0xa00 0xa00 0xa00 0xa00 0xa00 0xa00 0xa00 0xa00 0xa00 0xa00 0xa00 0xa00 0xa00 0xa00 0xa00 0xa00 0xa00 0xa00 0xa00 0xa00 0xa00 0xa00 0xa00 0xa00 0xa00 0xa00 0xa00 0xa00 0xa00 0xa00 0xa00 0xa00 0xa00 0xa00 0xa00 0xa00 0xa00 0xa00 0xa00 0xa00 0xa00 0xa00 0xa00 0xa00 0xa00 0xa00 0xa00 0xa00 0xa00 0xa00 0xa00 0xa00 0xa00 0xa00 0xa00 0xa00 0xa00 0xa00 0xa00 0xa00 0xa00 0xa00 0xa00 0xa00 0xa00 0xa00 0xa00 0xa00 0xa00 0xa00 0xa00 0xa00 0xa00 0xa00 0xa00 0xa00 0xa00 0xa00 0xa00 0xa00 0xa00 0xa00 0xa00 0xa00 0xa00 0xa00 0xa00 0xa00 0xa00 0xa00 0xa00 0xa00 0xa00 0xa00 0xa00 0xa00 0xa00 0xa00 0xa00 0xa00 0xa00 0xa00 0xa00 0xa00 0xa00 0xa00 0xa00 0xa00 0xa00 0xa00 0xa00 0xa00 0xa00 0xa00 0xa00 0xa00 0xa00 0xa00 0xa00 0xa00 0xa00 0xa00 0xa00 0xa00 0xa00 0xa00 0xa00 0xa00 0xa00 0xa00 0xa00 0xa00 0xa00 0xa00 0xa00 0xa00 0xa00 0xa00 0xa00>;
					PS_Config_Lmt_Open_Rawdata_N = <0xfffffe01 0xfffffe01 0xfffffe01 0xfffffe01 0xfffffe01 0xfffffe01 0xfffffe01 0xfffffe01 0xfffffe01 0xfffffe01 0xfffffe01 0xfffffe01 0xfffffe01 0xfffffe01 0xfffffe01 0xfffffe01 0xfffffe01 0xfffffe01 0xfffffe01 0xfffffe01 0xfffffe01 0xfffffe01 0xfffffe01 0xfffffe01 0xfffffe01 0xfffffe01 0xfffffe01 0xfffffe01 0xfffffe01 0xfffffe01 0xfffffe01 0xfffffe01 0xfffffe01 0xfffffe01 0xfffffe01 0xfffffe01 0xfffffe01 0xfffffe01 0xfffffe01 0xfffffe01 0xfffffe01 0xfffffe01 0xfffffe01 0xfffffe01 0xfffffe01 0xfffffe01 0xfffffe01 0xfffffe01 0xfffffe01 0xfffffe01 0xfffffe01 0xfffffe01 0xfffffe01 0xfffffe01 0xfffffe01 0xfffffe01 0xfffffe01 0xfffffe01 0xfffffe01 0xfffffe01 0xfffffe01 0xfffffe01 0xfffffe01 0xfffffe01 0xfffffe01 0xfffffe01 0xfffffe01 0xfffffe01 0xfffffe01 0xfffffe01 0xfffffe01 0xfffffe01 0xfffffe01 0xfffffe01 0xfffffe01 0xfffffe01 0xfffffe01 0xfffffe01 0xfffffe01 0xfffffe01 0xfffffe01 0xfffffe01 0xfffffe01 0xfffffe01 0xfffffe01 0xfffffe01 0xfffffe01 0xfffffe01 0xfffffe01 0xfffffe01 0xfffffe01 0xfffffe01 0xfffffe01 0xfffffe01 0xfffffe01 0xfffffe01 0xfffffe01 0xfffffe01 0xfffffe01 0xfffffe01 0xfffffe01 0xfffffe01 0xfffffe01 0xfffffe01 0xfffffe01 0xfffffe01 0xfffffe01 0xfffffe01 0xfffffe01 0xfffffe01 0xfffffe01 0xfffffe01 0xfffffe01 0xfffffe01 0xfffffe01 0xfffffe01 0xfffffe01 0xfffffe01 0xfffffe01 0xfffffe01 0xfffffe01 0xfffffe01 0xfffffe01 0xfffffe01 0xfffffe01 0xfffffe01 0xfffffe01 0xfffffe01 0xfffffe01 0xfffffe01 0xfffffe01 0xfffffe01 0xfffffe01 0xfffffe01 0xfffffe01 0xfffffe01 0xfffffe01 0xfffffe01 0xfffffe01 0xfffffe01 0xfffffe01 0xfffffe01 0xfffffe01 0xfffffe01 0xfffffe01 0xfffffe01 0xfffffe01 0xfffffe01 0xfffffe01 0xfffffe01 0xfffffe01 0xfffffe01 0xfffffe01 0xfffffe01 0xfffffe01 0xfffffe01 0xfffffe01 0xfffffe01 0xfffffe01 0xfffffe01 0xfffffe01 0xfffffe01 0xfffffe01 0xfffffe01 0xfffffe01 0xfffffe01 0xfffffe01 0xfffffe01 0xfffffe01 0xfffffe01 0xfffffe01 0xfffffe01 0xfffffe01 0xfffffe01 0xfffffe01 0xfffffe01 0xfffffe01 0xfffffe01 0xfffffe01 0xfffffe01 0xfffffe01 0xfffffe01 0xfffffe01 0xfffffe01 0xfffffe01 0xfffffe01 0xfffffe01 0xfffffe01 0xfffffe01 0xfffffe01 0xfffffe01 0xfffffe01 0xfffffe01 0xfffffe01 0xfffffe01 0xfffffe01 0xfffffe01 0xfffffe01 0xfffffe01 0xfffffe01 0xfffffe01 0xfffffe01 0xfffffe01 0xfffffe01 0xfffffe01 0xfffffe01 0xfffffe01 0xfffffe01 0xfffffe01 0xfffffe01 0xfffffe01 0xfffffe01 0xfffffe01 0xfffffe01 0xfffffe01 0xfffffe01 0xfffffe01 0xfffffe01 0xfffffe01 0xfffffe01 0xfffffe01 0xfffffe01 0xfffffe01 0xfffffe01 0xfffffe01 0xfffffe01 0xfffffe01 0xfffffe01 0xfffffe01 0xfffffe01 0xfffffe01 0xfffffe01 0xfffffe01 0xfffffe01 0xfffffe01 0xfffffe01 0xfffffe01 0xfffffe01 0xfffffe01 0xfffffe01 0xfffffe01 0xfffffe01 0xfffffe01 0xfffffe01 0xfffffe01 0xfffffe01 0xfffffe01 0xfffffe01 0xfffffe01 0xfffffe01 0xfffffe01 0xfffffe01 0xfffffe01 0xfffffe01 0xfffffe01 0xfffffe01 0xfffffe01 0xfffffe01 0xfffffe01 0xfffffe01 0xfffffe01 0xfffffe01 0xfffffe01 0xfffffe01 0xfffffe01 0xfffffe01 0xfffffe01 0xfffffe01 0xfffffe01 0xfffffe01 0xfffffe01 0xfffffe01 0xfffffe01 0xfffffe01 0xfffffe01 0xfffffe01 0xfffffe01 0xfffffe01 0xfffffe01 0xfffffe01 0xfffffe01 0xfffffe01 0xfffffe01 0xfffffe01 0xfffffe01 0xfffffe01 0xfffffe01 0xfffffe01 0xfffffe01 0xfffffe01 0xfffffe01 0xfffffe01 0xfffffe01 0xfffffe01 0xfffffe01 0xfffffe01 0xfffffe01 0xfffffe01 0xfffffe01 0xfffffe01 0xfffffe01 0xfffffe01 0xfffffe01 0xfffffe01 0xfffffe01 0xfffffe01 0xfffffe01 0xfffffe01 0xfffffe01 0xfffffe01 0xfffffe01 0xfffffe01 0xfffffe01 0xfffffe01 0xfffffe01 0xfffffe01 0xfffffe01 0xfffffe01 0xfffffe01 0xfffffe01 0xfffffe01 0xfffffe01 0xfffffe01 0xfffffe01 0xfffffe01 0xfffffe01 0xfffffe01 0xfffffe01 0xfffffe01 0xfffffe01 0xfffffe01 0xfffffe01 0xfffffe01 0xfffffe01 0xfffffe01 0xfffffe01 0xfffffe01 0xfffffe01 0xfffffe01 0xfffffe01 0xfffffe01 0xfffffe01 0xfffffe01 0xfffffe01 0xfffffe01 0xfffffe01 0xfffffe01 0xfffffe01 0xfffffe01 0xfffffe01 0xfffffe01 0xfffffe01 0xfffffe01 0xfffffe01 0xfffffe01 0xfffffe01 0xfffffe01 0xfffffe01 0xfffffe01 0xfffffe01 0xfffffe01 0xfffffe01 0xfffffe01 0xfffffe01 0xfffffe01 0xfffffe01 0xfffffe01 0xfffffe01 0xfffffe01 0xfffffe01 0xfffffe01 0xfffffe01 0xfffffe01 0xfffffe01 0xfffffe01 0xfffffe01 0xfffffe01 0xfffffe01 0xfffffe01 0xfffffe01 0xfffffe01 0xfffffe01 0xfffffe01 0xfffffe01 0xfffffe01 0xfffffe01 0xfffffe01 0xfffffe01 0xfffffe01 0xfffffe01 0xfffffe01 0xfffffe01 0xfffffe01 0xfffffe01 0xfffffe01 0xfffffe01 0xfffffe01 0xfffffe01 0xfffffe01 0xfffffe01 0xfffffe01 0xfffffe01 0xfffffe01 0xfffffe01 0xfffffe01 0xfffffe01 0xfffffe01 0xfffffe01 0xfffffe01 0xfffffe01 0xfffffe01 0xfffffe01 0xfffffe01 0xfffffe01 0xfffffe01 0xfffffe01 0xfffffe01 0xfffffe01 0xfffffe01 0xfffffe01 0xfffffe01 0xfffffe01 0xfffffe01 0xfffffe01 0xfffffe01 0xfffffe01 0xfffffe01 0xfffffe01 0xfffffe01 0xfffffe01 0xfffffe01 0xfffffe01 0xfffffe01 0xfffffe01 0xfffffe01 0xfffffe01 0xfffffe01 0xfffffe01 0xfffffe01 0xfffffe01 0xfffffe01 0xfffffe01 0xfffffe01 0xfffffe01 0xfffffe01 0xfffffe01 0xfffffe01 0xfffffe01 0xfffffe01 0xfffffe01 0xfffffe01 0xfffffe01 0xfffffe01 0xfffffe01 0xfffffe01 0xfffffe01 0xfffffe01 0xfffffe01 0xfffffe01 0xfffffe01 0xfffffe01 0xfffffe01 0xfffffe01 0xfffffe01 0xfffffe01 0xfffffe01 0xfffffe01 0xfffffe01 0xfffffe01 0xfffffe01 0xfffffe01 0xfffffe01 0xfffffe01 0xfffffe01 0xfffffe01 0xfffffe01 0xfffffe01 0xfffffe01 0xfffffe01 0xfffffe01 0xfffffe01 0xfffffe01 0xfffffe01 0xfffffe01 0xfffffe01 0xfffffe01 0xfffffe01 0xfffffe01 0xfffffe01 0xfffffe01 0xfffffe01 0xfffffe01 0xfffffe01 0xfffffe01 0xfffffe01 0xfffffe01 0xfffffe01 0xfffffe01 0xfffffe01 0xfffffe01 0xfffffe01 0xfffffe01 0xfffffe01 0xfffffe01 0xfffffe01 0xfffffe01 0xfffffe01 0xfffffe01 0xfffffe01 0xfffffe01 0xfffffe01 0xfffffe01 0xfffffe01 0xfffffe01 0xfffffe01 0xfffffe01 0xfffffe01 0xfffffe01 0xfffffe01 0xfffffe01 0xfffffe01 0xfffffe01 0xfffffe01 0xfffffe01 0xfffffe01 0xfffffe01 0xfffffe01 0xfffffe01 0xfffffe01 0xfffffe01 0xfffffe01 0xfffffe01 0xfffffe01 0xfffffe01 0xfffffe01 0xfffffe01 0xfffffe01 0xfffffe01 0xfffffe01 0xfffffe01 0xfffffe01 0xfffffe01 0xfffffe01 0xfffffe01 0xfffffe01 0xfffffe01 0xfffffe01 0xfffffe01 0xfffffe01 0xfffffe01 0xfffffe01 0xfffffe01 0xfffffe01 0xfffffe01 0xfffffe01 0xfffffe01 0xfffffe01 0xfffffe01 0xfffffe01 0xfffffe01 0xfffffe01 0xfffffe01 0xfffffe01 0xfffffe01 0xfffffe01 0xfffffe01 0xfffffe01 0xfffffe01 0xfffffe01 0xfffffe01 0xfffffe01 0xfffffe01 0xfffffe01 0xfffffe01 0xfffffe01 0xfffffe01 0xfffffe01 0xfffffe01 0xfffffe01 0xfffffe01 0xfffffe01 0xfffffe01 0xfffffe01 0xfffffe01 0xfffffe01 0xfffffe01 0xfffffe01 0xfffffe01 0xfffffe01 0xfffffe01 0xfffffe01 0xfffffe01 0xfffffe01 0xfffffe01 0xfffffe01 0xfffffe01 0xfffffe01 0xfffffe01 0xfffffe01 0xfffffe01 0xfffffe01 0xfffffe01 0xfffffe01 0xfffffe01 0xfffffe01 0xfffffe01 0xfffffe01 0xfffffe01 0xfffffe01 0xfffffe01 0xfffffe01 0xfffffe01 0xfffffe01 0xfffffe01 0xfffffe01 0xfffffe01 0xfffffe01 0xfffffe01 0xfffffe01 0xfffffe01 0xfffffe01 0xfffffe01 0xfffffe01 0xfffffe01 0xfffffe01 0xfffffe01 0xfffffe01 0xfffffe01 0xfffffe01 0xfffffe01 0xfffffe01 0xfffffe01 0xfffffe01 0xfffffe01 0xfffffe01 0xfffffe01 0xfffffe01 0xfffffe01 0xfffffe01 0xfffffe01 0xfffffe01 0xfffffe01 0xfffffe01 0xfffffe01 0xfffffe01 0xfffffe01 0xfffffe01 0xfffffe01 0xfffffe01 0xfffffe01 0xfffffe01>;
					PS_Config_Lmt_Open_Rawdata_P = <0x1400 0x1400 0x1400 0x1400 0x1400 0x1400 0x1400 0x1400 0x1400 0x1400 0x1400 0x1400 0x1400 0x1400 0x1400 0x1400 0x1400 0x1400 0x1400 0x1400 0x1400 0x1400 0x1400 0x1400 0x1400 0x1400 0x1400 0x1400 0x1400 0x1400 0x1400 0x1400 0x1400 0x1400 0x1400 0x1400 0x1400 0x1400 0x1400 0x1400 0x1400 0x1400 0x1400 0x1400 0x1400 0x1400 0x1400 0x1400 0x1400 0x1400 0x1400 0x1400 0x1400 0x1400 0x1400 0x1400 0x1400 0x1400 0x1400 0x1400 0x1400 0x1400 0x1400 0x1400 0x1400 0x1400 0x1400 0x1400 0x1400 0x1400 0x1400 0x1400 0x1400 0x1400 0x1400 0x1400 0x1400 0x1400 0x1400 0x1400 0x1400 0x1400 0x1400 0x1400 0x1400 0x1400 0x1400 0x1400 0x1400 0x1400 0x1400 0x1400 0x1400 0x1400 0x1400 0x1400 0x1400 0x1400 0x1400 0x1400 0x1400 0x1400 0x1400 0x1400 0x1400 0x1400 0x1400 0x1400 0x1400 0x1400 0x1400 0x1400 0x1400 0x1400 0x1400 0x1400 0x1400 0x1400 0x1400 0x1400 0x1400 0x1400 0x1400 0x1400 0x1400 0x1400 0x1400 0x1400 0x1400 0x1400 0x1400 0x1400 0x1400 0x1400 0x1400 0x1400 0x1400 0x1400 0x1400 0x1400 0x1400 0x1400 0x1400 0x1400 0x1400 0x1400 0x1400 0x1400 0x1400 0x1400 0x1400 0x1400 0x1400 0x1400 0x1400 0x1400 0x1400 0x1400 0x1400 0x1400 0x1400 0x1400 0x1400 0x1400 0x1400 0x1400 0x1400 0x1400 0x1400 0x1400 0x1400 0x1400 0x1400 0x1400 0x1400 0x1400 0x1400 0x1400 0x1400 0x1400 0x1400 0x1400 0x1400 0x1400 0x1400 0x1400 0x1400 0x1400 0x1400 0x1400 0x1400 0x1400 0x1400 0x1400 0x1400 0x1400 0x1400 0x1400 0x1400 0x1400 0x1400 0x1400 0x1400 0x1400 0x1400 0x1400 0x1400 0x1400 0x1400 0x1400 0x1400 0x1400 0x1400 0x1400 0x1400 0x1400 0x1400 0x1400 0x1400 0x1400 0x1400 0x1400 0x1400 0x1400 0x1400 0x1400 0x1400 0x1400 0x1400 0x1400 0x1400 0x1400 0x1400 0x1400 0x1400 0x1400 0x1400 0x1400 0x1400 0x1400 0x1400 0x1400 0x1400 0x1400 0x1400 0x1400 0x1400 0x1400 0x1400 0x1400 0x1400 0x1400 0x1400 0x1400 0x1400 0x1400 0x1400 0x1400 0x1400 0x1400 0x1400 0x1400 0x1400 0x1400 0x1400 0x1400 0x1400 0x1400 0x1400 0x1400 0x1400 0x1400 0x1400 0x1400 0x1400 0x1400 0x1400 0x1400 0x1400 0x1400 0x1400 0x1400 0x1400 0x1400 0x1400 0x1400 0x1400 0x1400 0x1400 0x1400 0x1400 0x1400 0x1400 0x1400 0x1400 0x1400 0x1400 0x1400 0x1400 0x1400 0x1400 0x1400 0x1400 0x1400 0x1400 0x1400 0x1400 0x1400 0x1400 0x1400 0x1400 0x1400 0x1400 0x1400 0x1400 0x1400 0x1400 0x1400 0x1400 0x1400 0x1400 0x1400 0x1400 0x1400 0x1400 0x1400 0x1400 0x1400 0x1400 0x1400 0x1400 0x1400 0x1400 0x1400 0x1400 0x1400 0x1400 0x1400 0x1400 0x1400 0x1400 0x1400 0x1400 0x1400 0x1400 0x1400 0x1400 0x1400 0x1400 0x1400 0x1400 0x1400 0x1400 0x1400 0x1400 0x1400 0x1400 0x1400 0x1400 0x1400 0x1400 0x1400 0x1400 0x1400 0x1400 0x1400 0x1400 0x1400 0x1400 0x1400 0x1400 0x1400 0x1400 0x1400 0x1400 0x1400 0x1400 0x1400 0x1400 0x1400 0x1400 0x1400 0x1400 0x1400 0x1400 0x1400 0x1400 0x1400 0x1400 0x1400 0x1400 0x1400 0x1400 0x1400 0x1400 0x1400 0x1400 0x1400 0x1400 0x1400 0x1400 0x1400 0x1400 0x1400 0x1400 0x1400 0x1400 0x1400 0x1400 0x1400 0x1400 0x1400 0x1400 0x1400 0x1400 0x1400 0x1400 0x1400 0x1400 0x1400 0x1400 0x1400 0x1400 0x1400 0x1400 0x1400 0x1400 0x1400 0x1400 0x1400 0x1400 0x1400 0x1400 0x1400 0x1400 0x1400 0x1400 0x1400 0x1400 0x1400 0x1400 0x1400 0x1400 0x1400 0x1400 0x1400 0x1400 0x1400 0x1400 0x1400 0x1400 0x1400 0x1400 0x1400 0x1400 0x1400 0x1400 0x1400 0x1400 0x1400 0x1400 0x1400 0x1400 0x1400 0x1400 0x1400 0x1400 0x1400 0x1400 0x1400 0x1400 0x1400 0x1400 0x1400 0x1400 0x1400 0x1400 0x1400 0x1400 0x1400 0x1400 0x1400 0x1400 0x1400 0x1400 0x1400 0x1400 0x1400 0x1400 0x1400 0x1400 0x1400 0x1400 0x1400 0x1400 0x1400 0x1400 0x1400 0x1400 0x1400 0x1400 0x1400 0x1400 0x1400 0x1400 0x1400 0x1400 0x1400 0x1400 0x1400 0x1400 0x1400 0x1400 0x1400 0x1400 0x1400 0x1400 0x1400 0x1400 0x1400 0x1400 0x1400 0x1400 0x1400 0x1400 0x1400 0x1400 0x1400 0x1400 0x1400 0x1400 0x1400 0x1400 0x1400 0x1400 0x1400 0x1400 0x1400 0x1400 0x1400 0x1400 0x1400 0x1400 0x1400 0x1400 0x1400 0x1400 0x1400 0x1400 0x1400 0x1400 0x1400 0x1400 0x1400 0x1400 0x1400 0x1400 0x1400 0x1400 0x1400 0x1400 0x1400 0x1400 0x1400 0x1400 0x1400 0x1400 0x1400 0x1400 0x1400 0x1400 0x1400 0x1400 0x1400 0x1400 0x1400 0x1400 0x1400 0x1400 0x1400 0x1400 0x1400 0x1400 0x1400 0x1400 0x1400 0x1400 0x1400 0x1400 0x1400 0x1400 0x1400 0x1400 0x1400 0x1400 0x1400 0x1400 0x1400 0x1400 0x1400 0x1400 0x1400 0x1400 0x1400 0x1400 0x1400 0x1400 0x1400 0x1400 0x1400 0x1400 0x1400 0x1400 0x1400 0x1400 0x1400 0x1400 0x1400 0x1400 0x1400 0x1400 0x1400 0x1400 0x1400 0x1400 0x1400 0x1400 0x1400 0x1400 0x1400 0x1400 0x1400 0x1400 0x1400 0x1400 0x1400 0x1400 0x1400 0x1400 0x1400 0x1400 0x1400 0x1400 0x1400 0x1400 0x1400 0x1400 0x1400 0x1400 0x1400 0x1400>;
					PS_Config_Lmt_Short_Rawdata_N = <0x2710 0x2710 0x2710 0x2710 0x2710 0x2710 0x2710 0x2710 0x2710 0x2710 0x2710 0x2710 0x2710 0x2710 0x2710 0x2710 0x2710 0x2710 0x2710 0x2710 0x2710 0x2710 0x2710 0x2710 0x2710 0x2710 0x2710 0x2710 0x2710 0x2710 0x2710 0x2710 0x2710 0x2710 0x2710 0x2710 0x2710 0x2710 0x2710 0x2710 0x2710 0x2710 0x2710 0x2710 0x2710 0x2710 0x2710 0x2710 0x2710 0x2710 0x2710 0x2710 0x2710 0x2710 0x2710 0x2710 0x2710 0x2710 0x2710 0x2710 0x2710 0x2710 0x2710 0x2710 0x2710 0x2710 0x2710 0x2710 0x2710 0x2710 0x2710 0x2710 0x2710 0x2710 0x2710 0x2710 0x2710 0x2710 0x2710 0x2710 0x2710 0x2710 0x2710 0x2710 0x2710 0x2710 0x2710 0x2710 0x2710 0x2710 0x2710 0x2710 0x2710 0x2710 0x2710 0x2710 0x2710 0x2710 0x2710 0x2710 0x2710 0x2710 0x2710 0x2710 0x2710 0x2710 0x2710 0x2710 0x2710 0x2710 0x2710 0x2710 0x2710 0x2710 0x2710 0x2710 0x2710 0x2710 0x2710 0x2710 0x2710 0x2710 0x2710 0x2710 0x2710 0x2710 0x2710 0x2710 0x2710 0x2710 0x2710 0x2710 0x2710 0x2710 0x2710 0x2710 0x2710 0x2710 0x2710 0x2710 0x2710 0x2710 0x2710 0x2710 0x2710 0x2710 0x2710 0x2710 0x2710 0x2710 0x2710 0x2710 0x2710 0x2710 0x2710 0x2710 0x2710 0x2710 0x2710 0x2710 0x2710 0x2710 0x2710 0x2710 0x2710 0x2710 0x2710 0x2710 0x2710 0x2710 0x2710 0x2710 0x2710 0x2710 0x2710 0x2710 0x2710 0x2710 0x2710 0x2710 0x2710 0x2710 0x2710 0x2710 0x2710 0x2710 0x2710 0x2710 0x2710 0x2710 0x2710 0x2710 0x2710 0x2710 0x2710 0x2710 0x2710 0x2710 0x2710 0x2710 0x2710 0x2710 0x2710 0x2710 0x2710 0x2710 0x2710 0x2710 0x2710 0x2710 0x2710 0x2710 0x2710 0x2710 0x2710 0x2710 0x2710 0x2710 0x2710 0x2710 0x2710 0x2710 0x2710 0x2710 0x2710 0x2710 0x2710 0x2710 0x2710 0x2710 0x2710 0x2710 0x2710 0x2710 0x2710 0x2710 0x2710 0x2710 0x2710 0x2710 0x2710 0x2710 0x2710 0x2710 0x2710 0x2710 0x2710 0x2710 0x2710 0x2710 0x2710 0x2710 0x2710 0x2710 0x2710 0x2710 0x2710 0x2710 0x2710 0x2710 0x2710 0x2710 0x2710 0x2710 0x2710 0x2710 0x2710 0x2710 0x2710 0x2710 0x2710 0x2710 0x2710 0x2710 0x2710 0x2710 0x2710 0x2710 0x2710 0x2710 0x2710 0x2710 0x2710 0x2710 0x2710 0x2710 0x2710 0x2710 0x2710 0x2710 0x2710 0x2710 0x2710 0x2710 0x2710 0x2710 0x2710 0x2710 0x2710 0x2710 0x2710 0x2710 0x2710 0x2710 0x2710 0x2710 0x2710 0x2710 0x2710 0x2710 0x2710 0x2710 0x2710 0x2710 0x2710 0x2710 0x2710 0x2710 0x2710 0x2710 0x2710 0x2710 0x2710 0x2710 0x2710 0x2710 0x2710 0x2710 0x2710 0x2710 0x2710 0x2710 0x2710 0x2710 0x2710 0x2710 0x2710 0x2710 0x2710 0x2710 0x2710 0x2710 0x2710 0x2710 0x2710 0x2710 0x2710 0x2710 0x2710 0x2710 0x2710 0x2710 0x2710 0x2710 0x2710 0x2710 0x2710 0x2710 0x2710 0x2710 0x2710 0x2710 0x2710 0x2710 0x2710 0x2710 0x2710 0x2710 0x2710 0x2710 0x2710 0x2710 0x2710 0x2710 0x2710 0x2710 0x2710 0x2710 0x2710 0x2710 0x2710 0x2710 0x2710 0x2710 0x2710 0x2710 0x2710 0x2710 0x2710 0x2710 0x2710 0x2710 0x2710 0x2710 0x2710 0x2710 0x2710 0x2710 0x2710 0x2710 0x2710 0x2710 0x2710 0x2710 0x2710 0x2710 0x2710 0x2710 0x2710 0x2710 0x2710 0x2710 0x2710 0x2710 0x2710 0x2710 0x2710 0x2710 0x2710 0x2710 0x2710 0x2710 0x2710 0x2710 0x2710 0x2710 0x2710 0x2710 0x2710 0x2710 0x2710 0x2710 0x2710 0x2710 0x2710 0x2710 0x2710 0x2710 0x2710 0x2710 0x2710 0x2710 0x2710 0x2710 0x2710 0x2710 0x2710 0x2710 0x2710 0x2710 0x2710 0x2710 0x2710 0x2710 0x2710 0x2710 0x2710 0x2710 0x2710 0x2710 0x2710 0x2710 0x2710 0x2710 0x2710 0x2710 0x2710 0x2710 0x2710 0x2710 0x2710 0x2710 0x2710 0x2710 0x2710 0x2710 0x2710 0x2710 0x2710 0x2710 0x2710 0x2710 0x2710 0x2710 0x2710 0x2710 0x2710 0x2710 0x2710 0x2710 0x2710 0x2710 0x2710 0x2710 0x2710 0x2710 0x2710 0x2710 0x2710 0x2710 0x2710 0x2710 0x2710 0x2710 0x2710 0x2710 0x2710 0x2710 0x2710 0x2710 0x2710 0x2710 0x2710 0x2710 0x2710 0x2710 0x2710 0x2710 0x2710 0x2710 0x2710 0x2710 0x2710 0x2710 0x2710 0x2710 0x2710 0x2710 0x2710 0x2710 0x2710 0x2710 0x2710 0x2710 0x2710 0x2710 0x2710 0x2710 0x2710 0x2710 0x2710 0x2710 0x2710 0x2710 0x2710 0x2710 0x2710 0x2710 0x2710 0x2710 0x2710 0x2710 0x2710 0x2710 0x2710 0x2710 0x2710 0x2710 0x2710 0x2710 0x2710 0x2710 0x2710 0x2710 0x2710 0x2710 0x2710 0x2710 0x2710 0x2710 0x2710 0x2710 0x2710 0x2710 0x2710 0x2710 0x2710 0x2710 0x2710 0x2710 0x2710 0x2710 0x2710 0x2710 0x2710 0x2710 0x2710 0x2710 0x2710 0x2710 0x2710 0x2710 0x2710 0x2710 0x2710 0x2710 0x2710 0x2710 0x2710 0x2710 0x2710 0x2710 0x2710 0x2710 0x2710 0x2710 0x2710 0x2710 0x2710 0x2710 0x2710 0x2710 0x2710 0x2710 0x2710 0x2710 0x2710 0x2710 0x2710 0x2710 0x2710 0x2710 0x2710 0x2710 0x2710 0x2710 0x2710 0x2710 0x2710 0x2710 0x2710 0x2710 0x2710 0x2710 0x2710 0x2710 0x2710 0x2710 0x2710 0x2710 0x2710 0x2710 0x2710 0x2710 0x2710 0x2710 0x2710 0x2710 0x2710 0x2710 0x2710>;
					PS_Config_Lmt_Short_Rawdata_P = <0x36b8 0x36b8 0x36b8 0x36b8 0x36b8 0x36b8 0x36b8 0x36b8 0x36b8 0x36b8 0x36b8 0x36b8 0x36b8 0x36b8 0x36b8 0x36b8 0x36b8 0x36b8 0x36b8 0x36b8 0x36b8 0x36b8 0x36b8 0x36b8 0x36b8 0x36b8 0x36b8 0x36b8 0x36b8 0x36b8 0x36b8 0x36b8 0x36b8 0x36b8 0x36b8 0x36b8 0x36b8 0x36b8 0x36b8 0x36b8 0x36b8 0x36b8 0x36b8 0x36b8 0x36b8 0x36b8 0x36b8 0x36b8 0x36b8 0x36b8 0x36b8 0x36b8 0x36b8 0x36b8 0x36b8 0x36b8 0x36b8 0x36b8 0x36b8 0x36b8 0x36b8 0x36b8 0x36b8 0x36b8 0x36b8 0x36b8 0x36b8 0x36b8 0x36b8 0x36b8 0x36b8 0x36b8 0x36b8 0x36b8 0x36b8 0x36b8 0x36b8 0x36b8 0x36b8 0x36b8 0x36b8 0x36b8 0x36b8 0x36b8 0x36b8 0x36b8 0x36b8 0x36b8 0x36b8 0x36b8 0x36b8 0x36b8 0x36b8 0x36b8 0x36b8 0x36b8 0x36b8 0x36b8 0x36b8 0x36b8 0x36b8 0x36b8 0x36b8 0x36b8 0x36b8 0x36b8 0x36b8 0x36b8 0x36b8 0x36b8 0x36b8 0x36b8 0x36b8 0x36b8 0x36b8 0x36b8 0x36b8 0x36b8 0x36b8 0x36b8 0x36b8 0x36b8 0x36b8 0x36b8 0x36b8 0x36b8 0x36b8 0x36b8 0x36b8 0x36b8 0x36b8 0x36b8 0x36b8 0x36b8 0x36b8 0x36b8 0x36b8 0x36b8 0x36b8 0x36b8 0x36b8 0x36b8 0x36b8 0x36b8 0x36b8 0x36b8 0x36b8 0x36b8 0x36b8 0x36b8 0x36b8 0x36b8 0x36b8 0x36b8 0x36b8 0x36b8 0x36b8 0x36b8 0x36b8 0x36b8 0x36b8 0x36b8 0x36b8 0x36b8 0x36b8 0x36b8 0x36b8 0x36b8 0x36b8 0x36b8 0x36b8 0x36b8 0x36b8 0x36b8 0x36b8 0x36b8 0x36b8 0x36b8 0x36b8 0x36b8 0x36b8 0x36b8 0x36b8 0x36b8 0x36b8 0x36b8 0x36b8 0x36b8 0x36b8 0x36b8 0x36b8 0x36b8 0x36b8 0x36b8 0x36b8 0x36b8 0x36b8 0x36b8 0x36b8 0x36b8 0x36b8 0x36b8 0x36b8 0x36b8 0x36b8 0x36b8 0x36b8 0x36b8 0x36b8 0x36b8 0x36b8 0x36b8 0x36b8 0x36b8 0x36b8 0x36b8 0x36b8 0x36b8 0x36b8 0x36b8 0x36b8 0x36b8 0x36b8 0x36b8 0x36b8 0x36b8 0x36b8 0x36b8 0x36b8 0x36b8 0x36b8 0x36b8 0x36b8 0x36b8 0x36b8 0x36b8 0x36b8 0x36b8 0x36b8 0x36b8 0x36b8 0x36b8 0x36b8 0x36b8 0x36b8 0x36b8 0x36b8 0x36b8 0x36b8 0x36b8 0x36b8 0x36b8 0x36b8 0x36b8 0x36b8 0x36b8 0x36b8 0x36b8 0x36b8 0x36b8 0x36b8 0x36b8 0x36b8 0x36b8 0x36b8 0x36b8 0x36b8 0x36b8 0x36b8 0x36b8 0x36b8 0x36b8 0x36b8 0x36b8 0x36b8 0x36b8 0x36b8 0x36b8 0x36b8 0x36b8 0x36b8 0x36b8 0x36b8 0x36b8 0x36b8 0x36b8 0x36b8 0x36b8 0x36b8 0x36b8 0x36b8 0x36b8 0x36b8 0x36b8 0x36b8 0x36b8 0x36b8 0x36b8 0x36b8 0x36b8 0x36b8 0x36b8 0x36b8 0x36b8 0x36b8 0x36b8 0x36b8 0x36b8 0x36b8 0x36b8 0x36b8 0x36b8 0x36b8 0x36b8 0x36b8 0x36b8 0x36b8 0x36b8 0x36b8 0x36b8 0x36b8 0x36b8 0x36b8 0x36b8 0x36b8 0x36b8 0x36b8 0x36b8 0x36b8 0x36b8 0x36b8 0x36b8 0x36b8 0x36b8 0x36b8 0x36b8 0x36b8 0x36b8 0x36b8 0x36b8 0x36b8 0x36b8 0x36b8 0x36b8 0x36b8 0x36b8 0x36b8 0x36b8 0x36b8 0x36b8 0x36b8 0x36b8 0x36b8 0x36b8 0x36b8 0x36b8 0x36b8 0x36b8 0x36b8 0x36b8 0x36b8 0x36b8 0x36b8 0x36b8 0x36b8 0x36b8 0x36b8 0x36b8 0x36b8 0x36b8 0x36b8 0x36b8 0x36b8 0x36b8 0x36b8 0x36b8 0x36b8 0x36b8 0x36b8 0x36b8 0x36b8 0x36b8 0x36b8 0x36b8 0x36b8 0x36b8 0x36b8 0x36b8 0x36b8 0x36b8 0x36b8 0x36b8 0x36b8 0x36b8 0x36b8 0x36b8 0x36b8 0x36b8 0x36b8 0x36b8 0x36b8 0x36b8 0x36b8 0x36b8 0x36b8 0x36b8 0x36b8 0x36b8 0x36b8 0x36b8 0x36b8 0x36b8 0x36b8 0x36b8 0x36b8 0x36b8 0x36b8 0x36b8 0x36b8 0x36b8 0x36b8 0x36b8 0x36b8 0x36b8 0x36b8 0x36b8 0x36b8 0x36b8 0x36b8 0x36b8 0x36b8 0x36b8 0x36b8 0x36b8 0x36b8 0x36b8 0x36b8 0x36b8 0x36b8 0x36b8 0x36b8 0x36b8 0x36b8 0x36b8 0x36b8 0x36b8 0x36b8 0x36b8 0x36b8 0x36b8 0x36b8 0x36b8 0x36b8 0x36b8 0x36b8 0x36b8 0x36b8 0x36b8 0x36b8 0x36b8 0x36b8 0x36b8 0x36b8 0x36b8 0x36b8 0x36b8 0x36b8 0x36b8 0x36b8 0x36b8 0x36b8 0x36b8 0x36b8 0x36b8 0x36b8 0x36b8 0x36b8 0x36b8 0x36b8 0x36b8 0x36b8 0x36b8 0x36b8 0x36b8 0x36b8 0x36b8 0x36b8 0x36b8 0x36b8 0x36b8 0x36b8 0x36b8 0x36b8 0x36b8 0x36b8 0x36b8 0x36b8 0x36b8 0x36b8 0x36b8 0x36b8 0x36b8 0x36b8 0x36b8 0x36b8 0x36b8 0x36b8 0x36b8 0x36b8 0x36b8 0x36b8 0x36b8 0x36b8 0x36b8 0x36b8 0x36b8 0x36b8 0x36b8 0x36b8 0x36b8 0x36b8 0x36b8 0x36b8 0x36b8 0x36b8 0x36b8 0x36b8 0x36b8 0x36b8 0x36b8 0x36b8 0x36b8 0x36b8 0x36b8 0x36b8 0x36b8 0x36b8 0x36b8 0x36b8 0x36b8 0x36b8 0x36b8 0x36b8 0x36b8 0x36b8 0x36b8 0x36b8 0x36b8 0x36b8 0x36b8 0x36b8 0x36b8 0x36b8 0x36b8 0x36b8 0x36b8 0x36b8 0x36b8 0x36b8 0x36b8 0x36b8 0x36b8 0x36b8 0x36b8 0x36b8 0x36b8 0x36b8 0x36b8 0x36b8 0x36b8 0x36b8 0x36b8 0x36b8 0x36b8 0x36b8 0x36b8 0x36b8 0x36b8 0x36b8 0x36b8 0x36b8 0x36b8 0x36b8 0x36b8 0x36b8 0x36b8 0x36b8 0x36b8 0x36b8 0x36b8 0x36b8 0x36b8 0x36b8 0x36b8 0x36b8 0x36b8 0x36b8 0x36b8 0x36b8 0x36b8 0x36b8 0x36b8 0x36b8 0x36b8 0x36b8 0x36b8 0x36b8 0x36b8 0x36b8 0x36b8 0x36b8 0x36b8 0x36b8 0x36b8 0x36b8 0x36b8 0x36b8 0x36b8 0x36b8 0x36b8 0x36b8 0x36b8 0x36b8 0x36b8 0x36b8 0x36b8 0x36b8 0x36b8 0x36b8 0x36b8 0x36b8 0x36b8 0x36b8 0x36b8 0x36b8 0x36b8 0x36b8 0x36b8 0x36b8 0x36b8 0x36b8 0x36b8 0x36b8 0x36b8 0x36b8 0x36b8 0x36b8 0x36b8 0x36b8 0x36b8 0x36b8>;
					X_Channel = <0x12>;
					Y_Channel = <0x24>;
					compatible = "novatek-mp-criteria-nvtpid";
				};
			};
		};
	};

	fragment@8 {
		target = <0xffffffff>;

		__overlay__ {
			chnl-in-i2c = <0x0>;
			pmic-type-num = <0x0>;
			slew-rate = <0x249f>;
			top-dvfs-adi-state = <0x70 0x0 0xf>;
			tuning-latency-us = <0x0>;
			voltage-down-delay = <0x32 0x64 0x0 0xffff 0x600 0x64 0x64 0x10 0xffff 0xa00 0x96 0x60 0x0 0xffff 0xf00 0xc8 0x60 0x10 0xffff 0x1400 0xfa 0x5c 0x0 0xffff 0x1900 0x12c 0x5c 0x10 0xffff 0x1e00 0x15e 0x114 0x0 0xffff 0x2300>;
			voltage-grade = <0x0 0xf0 0xf4 0x0 0x1ff 0x1 0xf0 0xf4 0x9 0x1ff 0x2 0x100 0xf4 0x12 0x1ff 0x3 0x110 0xf8 0x0 0x1ff 0x4 0x120 0xf8 0x9 0x1ff 0x5 0x130 0xf8 0x12 0x1ff 0x6 0x140 0xfc 0x0 0x1ff 0x7 0x140 0xfc 0x9 0x1ff>;
			voltage-grade-num = <0x8>;
			voltage-up-delay = <0x32 0x58 0x0 0xffff 0x600 0x64 0x58 0x10 0xffff 0xa00 0x96 0x54 0x0 0xffff 0xf00 0xc8 0x54 0x10 0xffff 0x1400 0xfa 0x50 0x0 0xffff 0x1900 0x12c 0x50 0x10 0xffff 0x1e00 0x15e 0x110 0x0 0xffff 0x2300>;
		};
	};

	fragment@9 {
		target = <0xffffffff>;

		__overlay__ {
			chnl-i2c-used;
			chnl-in-i2c = <0x1>;
			pmic-type-num = <0x2>;
			slew-rate = <0xfa0>;
			supply-type-sel = <0x120 0x0 0x1>;
			third-pmic-used;
			top-dvfs-i2c-state = <0x9c 0x4 0x1f>;
			tuning-latency-us = <0x0>;
			voltage-down-delay = <0x32 0x90 0x0 0xffff 0x600 0x64 0x90 0x10 0xffff 0xa00 0x96 0x8c 0x0 0xffff 0xf00 0xc8 0x8c 0x10 0xffff 0x1400 0xfa 0x88 0x0 0xffff 0x1900 0x12c 0x88 0x10 0xffff 0x1e00 0x15e 0x11c 0x0 0xffff 0x2300>;
			voltage-grade = <0x0 0x8f 0x12c 0x0 0xff 0x1 0x94 0x12c 0x8 0xff 0x2 0x99 0x12c 0x10 0xff 0x3 0x9e 0x12c 0x18 0xff 0x4 0xa3 0x130 0x0 0xff 0x5 0xa8 0x130 0x8 0xff 0x6 0xa8 0x130 0x10 0xff 0x7 0xa8 0x130 0x18 0xff>;
			voltage-grade-num = <0x8>;
			voltage-up-delay = <0x32 0x84 0x0 0xffff 0x1600 0x64 0x84 0x10 0xffff 0x1a00 0x96 0x80 0x0 0xffff 0x1f00 0xc8 0x80 0x10 0xffff 0x2400 0xfa 0x7c 0x0 0xffff 0x2900 0x12c 0x7c 0x10 0xffff 0x2e00 0x15e 0x118 0x0 0xffff 0x3300>;
		};
	};
};
