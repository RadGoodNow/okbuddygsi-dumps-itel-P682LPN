/dts-v1/;

/ {
	compatible = "sprd,ums9230-zebu";
	model = "Spreadtrum UMS9230 Zebu Board";
	sprd,sc-id = "ums9230-zebu backdoor 1000";

	__fixups__ {
		chosen = "/fragment@0:target:0";
	};

	fragment@0 {
		target = <0xffffffff>;

		__overlay__ {
			bootargs_ext = "androidboot.hardware=ums9230_zebu androidboot.dtbo_idx=0androidboot.boot_devices=memdisk0";
		};
	};
};
